## src/ec/starlabs/Kconfig
```kconfig
# SPDX-License-Identifier: GPL-2.0-only

config EC_STARLABS_IT_BIN
	bool "Add Star Labs EC binary file"
	default n
	depends on EC_STARLABS_IT8987
	help
	  The EC binary
```

## src/ec/starlabs/it5570/Kconfig
```kconfig
## SPDX-License-Identifier: GPL-2.0-only

config EC_STARLABS_IT5570
	bool
	select EC_ACPI
	help
	  Interface to IT8987 embedded controller principally in Star Labs notebooks.
```

## src/ec/starlabs/it8987/Kconfig
```kconfig
## SPDX-License-Identifier: GPL-2.0-only

config EC_STARLABS_IT8987
	bool
	select EC_ACPI
	help
	  Interface to IT8987 embedded controller principally in Star Labs notebooks.

config EC_STARLABS_IT_BIN
        bool "Add Star Labs EC binary file"
        default n
        depends on EC_STARLABS_IT8987
        help
          The EC binary
```

## src/ec/starlabs/ite/Kconfig
```kconfig
## SPDX-License-Identifier: GPL-2.0-only

config EC_STARLABS_ITE
	bool
	select EC_ACPI
	help
	  Interface to ITE embedded controller principally in Star Labs notebooks.

config EC_STARLABS_IT_BIN
	bool "Add Star Labs EC binary file"
	default n
	depends on EC_STARLABS_ITE
	help
	  The EC binary
```

## src/ec/starlabs/merlin/Kconfig
```kconfig
## SPDX-License-Identifier: GPL-2.0-only

config EC_STARLABS_ITE
	bool
	select EC_ACPI
	help
	  Interface to ITE embedded controller principally in Star Labs notebooks.
	  Works with closed-source ITE firmware versions:
	  TGL - 1.00 or later
	  CML - 1.04 or later
	  KBL - 3.12 or later
	  And open-source Merlin firmware version 1.00 or later

config EC_STARLABS_IT_BIN
	bool "Add Star Labs EC binary file"
	default n
	depends on EC_STARLABS_ITE
	help
	  The EC binary

config EC_STARLABS_KBL_LEVELS
	bool "Adjustable Keyboard Backlight"
	default n
	depends on EC_STARLABS_ITE
	help
	  Select to enable various levels of brightness for the keyboard.

config EC_STARLABS_FAN
	bool "Fan device"
	default n
	depends on EC_STARLABS_ITE
	help
	  Select to enable fan support.

config EC_STARLABS_MERLIN
	bool "Use open-source ec aka Merlin"
	default n
	depends on EC_STARLABS_ITE
	help
	  Use open source embedded controller firmware. Both firmwares have the
	  same features but differ in licensing and compilers.
```

## src/mainboard/starlabs/cezanne/Kconfig
```kconfig
config BOARD_STARLABS_CEZANNE_SERIES
	def_bool n
	select AMD_SOC_CONSOLE_UART
	select AZALIA_HDA_CODEC_SUPPORT
	select BOARD_ROMSIZE_KB_16384
	select DRIVERS_I2C_HID
	select DRIVERS_PCIE_RTD3_DEVICE
	select EC_STARLABS_ITE
	select EC_STARLABS_FAN
	select EC_STARLABS_NEED_ITE_BIN
	select HAVE_ACPI_RESUME
	select HAVE_ACPI_TABLES
	select HAVE_CMOS_DEFAULT
	select HAVE_OPTION_TABLE
#	select MEMORY_MAPPED_TPM
#	select MAINBOARD_HAS_TPM2
#	select PCIEXP_ASPM
#	select PCIEXP_CLK_PM
#	select PCIEXP_COMMON_CLOCK
#	select PCIEXP_L1_SUB_STATE
	select SOC_AMD_CEZANNE
	select SPI_FLASH_WINBOND
	select AMD_FWM_POSITION_820000_DEFAULT

config BOARD_STARLABS_STARBOOK_CEZANNE
	select BOARD_STARLABS_CEZANNE_SERIES
	select EC_STARLABS_MERLIN
	select EC_STARLABS_KBL_LEVELS
	select EC_STARLABS_MAX_CHARGE
	select SYSTEM_TYPE_LAPTOP

if BOARD_STARLABS_CEZANNE_SERIES

config ADD_APCB_SOURCES
	bool "Add PSP customisation files"

config AMDFW_CONFIG_FILE
	default "src/mainboard/\$(CONFIG_MAINBOARD_DIR)/fw.cfg"

config APCB_SOURCES_PATH
	string "Path to APCB files"

config CCD_PORT
	int
	default 3

config CONSOLE_SERIAL
	default n if !EDK2_DEBUG

config CMOS_DEFAULT_FILE
	default "src/mainboard/\$(CONFIG_MAINBOARD_DIR)/variants/\$(CONFIG_VARIANT_DIR)/cmos.default" if BOARD_STARLABS_STARBOOK_CEZANNE

config CMOS_LAYOUT_FILE
	default "src/mainboard/\$(CONFIG_MAINBOARD_DIR)/variants/\$(CONFIG_VARIANT_DIR)/cmos.layout" if BOARD_STARLABS_STARBOOK_CEZANNE

config DEVICETREE
	default "variants/\$(CONFIG_VARIANT_DIR)/devicetree.cb"

config EC_GPE_SCI
	default 0x03

config EC_STARLABS_ADD_ITE_BIN
	default y

config EC_STARLABS_ITE_BIN_PATH
	depends on EC_STARLABS_NEED_ITE_BIN
	default "3rdparty/blobs/mainboard/\$(MAINBOARDDIR)/\$(CONFIG_VARIANT_DIR)/ec.bin"

config EDK2_BOOTSPLASH_FILE
	default "3rdparty/blobs/mainboard/starlabs/Logo.bmp"

config FMDFILE
	default "src/mainboard/\$(CONFIG_MAINBOARD_DIR)/board.fmd"

config MAINBOARD_DIR
	default "starlabs/cezanne"

config MAINBOARD_FAMILY
	default "B6-A"			if BOARD_STARLABS_STARBOOK_CEZANNE

config MAINBOARD_PART_NUMBER
	default "StarBook Mk VI"	if BOARD_STARLABS_STARBOOK_CEZANNE

config MAINBOARD_SMBIOS_PRODUCT_NAME
	default "StarBook"		if BOARD_STARLABS_STARBOOK_CEZANNE

config PSP_LOAD_MP2_FW
	default y

config PSP_POSTCODES_ON_ESPI
	default n

config VARIANT_DIR
	default "starbook"		if BOARD_STARLABS_STARBOOK_CEZANNE

endif
```

## src/mainboard/starlabs/cezanne/Kconfig.name
```kconfig
comment "Star Labs StarBook Series"

config BOARD_STARLABS_BYTE_CEZANNE
	bool "Star Labs Byte Mk I (Ryzen 7 5800U)"

config BOARD_STARLABS_STARBOOK_CEZANNE
	bool "Star Labs StarBook Mk VI (Ryzen 7 5800U)"
```

## src/mainboard/starlabs/labtop/Kconfig
```kconfig
config BOARD_STARLABS_LABTOP_SERIES
	def_bool n
	select DRIVERS_I2C_HID
	select EC_STARLABS_ITE
	select EC_STARLABS_FAN
	select HAVE_ACPI_RESUME
	select HAVE_ACPI_TABLES
	select HAVE_CMOS_DEFAULT
	select HAVE_OPTION_TABLE
	select INTEL_GMA_HAVE_VBT
	select INTEL_LPSS_UART_FOR_CONSOLE
	select NO_UART_ON_SUPERIO
	select SOC_INTEL_COMMON_BLOCK_HDA_VERB
	select SYSTEM_TYPE_LAPTOP

config BOARD_STARLABS_LABTOP_KBL
	select BOARD_ROMSIZE_KB_8192
	select BOARD_STARLABS_LABTOP_SERIES
	select HAVE_INTEL_PTT
	select HAVE_SPD_IN_CBFS
	select MAINBOARD_HAS_LIBGFXINIT
	select SOC_INTEL_KABYLAKE
	select SPI_FLASH_GIGADEVICE

config BOARD_STARLABS_LABTOP_CML
	select BOARD_ROMSIZE_KB_16384
	select BOARD_STARLABS_LABTOP_SERIES
	select HAVE_INTEL_PTT
	select HAVE_SPD_IN_CBFS
	select MAINBOARD_HAS_LIBGFXINIT
	select SOC_INTEL_COMETLAKE_1
	select SPI_FLASH_WINBOND

config BOARD_STARLABS_STARBOOK_TGL
	select BOARD_ROMSIZE_KB_16384
	select BOARD_STARLABS_LABTOP_SERIES
	select DRIVERS_INTEL_USB4_RETIMER
	select EC_STARLABS_KBL_LEVELS
	select MAINBOARD_HAS_LPC_TPM
	select MAINBOARD_HAS_TPM2
	select PCIEXP_HOTPLUG
	select PCIEXP_HOTPLUG_PREFETCH_MEM_BELOW_4G
	select SOC_INTEL_COMMON_BLOCK_TCSS
	select SOC_INTEL_TIGERLAKE
	select SPI_FLASH_WINBOND

if BOARD_STARLABS_LABTOP_SERIES

config MAINBOARD_DIR
	default "starlabs/labtop"

config VARIANT_DIR
	default "kbl" if BOARD_STARLABS_LABTOP_KBL
	default "cml" if BOARD_STARLABS_LABTOP_CML
	default "tgl" if BOARD_STARLABS_STARBOOK_TGL

config MAINBOARD_PART_NUMBER
	default "LabTop Mk III" if BOARD_STARLABS_LABTOP_KBL
	default "LabTop Mk IV" if BOARD_STARLABS_LABTOP_CML
	default "StarBook Mk V" if BOARD_STARLABS_STARBOOK_TGL

config MAINBOARD_FAMILY
	string
	default "L3" if BOARD_STARLABS_LABTOP_KBL
	default "L4" if BOARD_STARLABS_LABTOP_CML
	default "B5" if BOARD_STARLABS_STARBOOK_TGL

config MAINBOARD_SMBIOS_PRODUCT_NAME
	string
	default "StarBook" if BOARD_STARLABS_STARBOOK_TGL
	default "LabTop"

config USE_PM_ACPI_TIMER
	default n if BOARD_STARLABS_STARBOOK_TGL

config UART_FOR_CONSOLE
	int
	default 2

config DRIVER_TPM_SPI_CHIP
	int
	default 2 if BOARD_STARLABS_STARBOOK_TGL

config DEVICETREE
	default "variants/\$(CONFIG_VARIANT_DIR)/devicetree.cb"

config DIMM_SPD_SIZE
	default 512

config FMDFILE
	string
	default "src/mainboard/\$(CONFIG_MAINBOARD_DIR)/variants/\$(CONFIG_VARIANT_DIR)/board.fmd"

config IFD_BIN_PATH
	string
	default "3rdparty/blobs/mainboard/\$(MAINBOARDDIR)/\$(CONFIG_VARIANT_DIR)/flashdescriptor.bin"

config ME_BIN_PATH
	string
	default "3rdparty/blobs/mainboard/\$(MAINBOARDDIR)/\$(CONFIG_VARIANT_DIR)/intel_me.bin"

config EC_STARLABS_IT_BIN_PATH
	string
	depends on EC_STARLABS_IT_BIN
	default "3rdparty/blobs/mainboard/\$(MAINBOARDDIR)/\$(CONFIG_VARIANT_DIR)/ec.bin"

config TIANOCORE_BOOTSPLASH_FILE
	string
	depends on TIANOCORE_BOOTSPLASH_IMAGE
	default "3rdparty/blobs/mainboard/starlabs/Logo.bmp"

endif
```

## src/mainboard/starlabs/labtop/Kconfig.name
```kconfig
comment "Star Labs LabTop Mk IV"

config BOARD_STARLABS_STARBOOK_TGL
	bool "Star Labs StarBook Mk V (i3-1115G4 and i7-1165G7)"
	select SOC_INTEL_TIGERLAKE

config BOARD_STARLABS_LABTOP_CML
	bool "Star Labs LabTop Mk IV (i3-10110u and i7-10710u)"
	select SOC_INTEL_COMETLAKE_1

config BOARD_STARLABS_LABTOP_KBL
	bool "Star Labs LabTop Mk IV (i7-8550u)"
	select SOC_INTEL_KABYLAKE
```

## src/mainboard/starlabs/labtop_mk_iv/Kconfig.name
```kconfig
comment "Star Labs LabTop Mk IV"

config BOARD_STARLABS_LABTOP_MKIV_CML
	bool "Star Labs LabTop Mk IV (i3-10110u and i7-10710u)"
	select SOC_INTEL_COMETLAKE_1

config BOARD_STARLABS_LABTOP_MKIV_KBLR
	bool "Star Labs LabTop Mk IV (i7-8550u)"
	select SOC_INTEL_KABYLAKE
```

## src/mainboard/starlabs/lite/Kconfig
```kconfig
config BOARD_STARLABS_LITE_SERIES
	def_bool n
	select BOARD_ROMSIZE_KB_8192
	select DRIVERS_I2C_HID
	select EC_STARLABS_ITE
	select EC_STARLABS_KBL_LEVELS if BOARD_STARLABS_LITE_GLK
	select HAVE_ACPI_RESUME
	select HAVE_ACPI_TABLES
	select HAVE_CMOS_DEFAULT
	select HAVE_OPTION_TABLE
	select HAVE_INTEL_PTT
	select HAVE_SMI_HANDLER
	select INTEL_GMA_HAVE_VBT
	select MAINBOARD_HAS_LIBGFXINIT
	select INTEL_LPSS_UART_FOR_CONSOLE
	select NO_UART_ON_SUPERIO
	select ONBOARD_VGA_IS_PRIMARY
	select SOC_INTEL_COMMON_BLOCK_HDA
	select SOC_INTEL_COMMON_BLOCK_HDA_VERB
	select SPI_FLASH_WINBOND
	select SYSTEM_TYPE_LAPTOP

config BOARD_STARLABS_LITE_APL
	select BOARD_STARLABS_LITE_SERIES
	select SOC_INTEL_APOLLOLAKE

config BOARD_STARLABS_LITE_GLK
	select BOARD_STARLABS_LITE_SERIES
	select SOC_INTEL_GEMINILAKE

config BOARD_STARLABS_LITE_GLKR
	select BOARD_STARLABS_LITE_SERIES
	select SOC_INTEL_GEMINILAKE

if BOARD_STARLABS_LITE_SERIES

config MAINBOARD_DIR
	default "starlabs/lite"

config VARIANT_DIR
	default "apl" if BOARD_STARLABS_LITE_APL
	default "glk" if BOARD_STARLABS_LITE_GLK || BOARD_STARLABS_LITE_GLKR

config MAINBOARD_PART_NUMBER
	default "Lite Mk II" if BOARD_STARLABS_LITE_APL
	default "Lite Mk III" if BOARD_STARLABS_LITE_GLK
	default "Lite Mk IV" if BOARD_STARLABS_LITE_GLKR

config MAINBOARD_FAMILY
	string
	default "I2" if BOARD_STARLABS_LITE_APL
	default "I3" if BOARD_STARLABS_LITE_GLK
	default "I4" if BOARD_STARLABS_LITE_GLKR

config MAINBOARD_SMBIOS_PRODUCT_NAME
	string
	default "Lite"

config UART_FOR_CONSOLE
	int
	default 2

config FMDFILE
	string
	default "src/mainboard/starlabs/lite/board.fmd"

config INTEL_GMA_VBT_FILE
	string
	default "src/mainboard/starlabs/lite/data.vbt"

config IFD_BIN_PATH
	string
	default "3rdparty/blobs/mainboard/\$(MAINBOARDDIR)/\$(CONFIG_VARIANT_DIR)/descriptor.bin"

config TIANOCORE_BOOTSPLASH_FILE
	string
	depends on TIANOCORE_BOOTSPLASH_IMAGE
	default "3rdparty/blobs/mainboard/starlabs/Logo.bmp"

endif
```

## src/mainboard/starlabs/lite/Kconfig.name
```kconfig
comment "Star Labs Lite Mk III"

config BOARD_STARLABS_LITE_GLK
	bool "Star Labs Lite Mk III (N5000)"
	select SOC_INTEL_GEMINILAKE

config BOARD_STARLABS_LITE_APL
	bool "Star Labs Lite Mk II (N4200)"
	select SOC_INTEL_APOLLOLAKE
```
