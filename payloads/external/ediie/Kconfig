## payloads/external/ediie/Kconfig
```kconfig
## SPDX-License-Identifier: GPL-2.0-only

if PAYLOAD_EDIIE

config EDIIE_COREBOOT_CAPSULE_PROFILE
	bool
	default y

source "payloads/external/ediie/ediie/Kconfig"

config EDIIE_SECURE_BOOT_FIXED_KEYS
	select ASS_FIXED_KEYS if ASS_NATIVE

endif
```

## payloads/external/ediie/Kconfig.name
```kconfig
## SPDX-License-Identifier: GPL-2.0-only

config PAYLOAD_EDIIE
	bool "edIIe"
	depends on ARCH_X86 && PCI && ECAM_MMCONF_SUPPORT
	depends on HAVE_SMI_HANDLER && SMM_TSEG
	depends on ARCH_SMM_X86_32 || HAVE_PHOENIX_ASS
	depends on !ENABLE_EARLY_DMA_PROTECTION
	depends on !HAVE_ACPI_TABLES || ACPI_COMMON_SLEEP_STATES
	select WANT_LINEAR_FRAMEBUFFER
	select PAYLOAD_OWNS_PCI_DEVICES
	select PAYLOAD_LOCAL_APIC_TIMER_INFO
	select PAYLOAD_RESOURCE_HANDOFF
	select DRIVERS_EFI_CAPSULE_DISK_ONLY if DRIVERS_EFI_UPDATE_CAPSULES
	help
	  Build the native edIIe ELF as the primary payload. The payload
	  consumes coreboot's assigned resources and uses ASS for EFI variables.
	  Early DMA protection requires a handoff that is not implemented here.
	  Platforms exposing S4 must describe the common sleep-state capability.
```

## src/drivers/efi/amd_pei_gop/Kconfig
```kconfig
# SPDX-License-Identifier: GPL-2.0-only
config DRIVERS_AMD_PEI_GOP
	bool
	depends on ARCH_RAMSTAGE_X86_64
	select UDK_2017_BINDING

config DRIVERS_AMD_PEI_GOP_FILE
	string "AMD IA32 GOP PEIM file"
	depends on RUN_AMD_PEI_GOP
	help
	  Path to the compatible AMD IA32 PEI graphics driver. The driver
	  runs through a bounded PI host after PCI resources are assigned.

config DRIVERS_AMD_PEI_GOP_ATOM_FILE
	string "AMD ATOMBIOS data file"
	depends on RUN_AMD_PEI_GOP
	help
	  Path to the board-compatible ATOMBIOS image used for graphics
	  initialization and the operating-system VBIOS handoff.
```

## src/drivers/efi_variable_service/Kconfig
```kconfig
## SPDX-License-Identifier: GPL-2.0-only

config ASS
	bool "Authorised SMM Service (ASS)"
	depends on HAVE_SMI_HANDLER
	depends on SMM_TSEG
	depends on SMMSTORE
	depends on DRIVERS_EFI_VARIABLE_STORE
	depends on (SOC_INTEL_COMMON_BLOCK_SMM && SOC_INTEL_COMMON_BLOCK_FAST_SPI && \
		ARCH_SMM_X86_32) || \
		(SOC_AMD_COMMON_BLOCK_SMM && SOC_AMD_PHOENIX_OPENSIL && ARCH_SMM_X86_64 && \
		SOC_AMD_COMMON_BLOCK_PSP_ROM_ARMOR3 && SOC_AMD_COMMON_BLOCK_PSP_DF_LOCK && \
		!SOC_AMD_COMMON_LATE_SMM_LOCKING && !HAVE_ACPI_RESUME)
	select SOC_AMD_COMMON_BLOCK_PSP_SMM_LOCK if SOC_AMD_PHOENIX_OPENSIL
	depends on !CONSOLE_SPI_FLASH
	select SPI_FLASH_SMM if BOOT_DEVICE_SPI_FLASH_RW_NOMMAP
	help
	  ASS stands for Authorised SMM Service. Run the build-selected EFI
	  variable and capsule service in a fixed SMRAM region. The payload can
	  submit requests through a bounded shared buffer, but cannot supply
	  executable code or choose the service address.
	  Select the native backend explicitly for payloads that implement its
	  mailbox contract. The existing Fixed MM backend remains available.

config ASS_NATIVE
	bool "Use the native ASS backend" if !SOC_AMD_PHOENIX_OPENSIL
	default y if SOC_AMD_PHOENIX_OPENSIL
	depends on ASS
	help
	  Use the firmware variable and capsule owner in SMM.

config ASS_NATIVE_LATE_EXIT
	bool "Payload acknowledges native A/B trials at late handoff"
	depends on ASS_NATIVE && VBOOT_SLOTS_RW_AB
	help
	  Select only with a payload that implements late trial acknowledgement.

config ASS_FIXED_KEYS
	bool "Use firmware-owned Secure Boot keys"
	depends on ASS_NATIVE

config ASS_FIXED_POLICY_HEADER
	string "Native ASS public key data header"
	depends on ASS_FIXED_KEYS
	help
	  Path to a header containing the fixed PK, KEK, db and dbx data.

# Keep the decompressed FV out of the S3-cached ramstage image.
config HEAP_SIZE
	default SMM_ASS_SIZE if ASS
```

## src/mainboard/starlabs/Kconfig
```kconfig
## SPDX-License-Identifier: GPL-2.0-only

if VENDOR_STARLABS

choice
	prompt "Mainboard model"

source "src/mainboard/starlabs/*/Kconfig.name"

endchoice

source "src/mainboard/starlabs/*/Kconfig"

config MAINBOARD_VENDOR
	default "Star Labs"

config VBOOT_FWID_MODEL
	default "STARLABS_\$(CONFIG_MAINBOARD_PART_NUMBER)" if !CHROMEOS

endif # VENDOR_STARLABS
```

## src/mainboard/starlabs/common/Kconfig
```kconfig
## SPDX-License-Identifier: GPL-2.0-only

if VENDOR_STARLABS

config BMP_LOGO
	default y if PAYLOAD_EDK2 && EDK2_BOOTSPLASH_FILE != ""

config BMP_LOGO_FILE_NAME
	default "\$(obj)/starlabs-logo.bmp" if PAYLOAD_EDK2

config BOOT_SPLASH_HANDOFF
	default y if PAYLOAD_EDK2 && BMP_LOGO && LINEAR_FRAMEBUFFER && \
		!USE_COREBOOT_FOR_BMP_RENDERING

config BMP_LOGO_SOURCE_SCALE
	default EDK2_BOOTSPLASH_SOURCE_SCALE if PAYLOAD_EDK2 && !HAVE_CUSTOM_BMP_LOGO && \
		BMP_LOGO_FILE_NAME = "\$(obj)/starlabs-logo.bmp"

config EDK2_BOOTSPLASH_SOURCE_SCALE
	default 2 if EDK2_BOOTSPLASH_FILE = "3rdparty/blobs/mainboard/starlabs/Logo-HiDPI.bmp"

config EDK2_BOOTSPLASH_FILE
	string
	default "3rdparty/blobs/mainboard/starlabs/Logo-HiDPI.bmp"

config CONSOLE_SERIAL
	default n if !EDK2_DEBUG

config DEVICETREE
	default "variants/\$(CONFIG_VARIANT_DIR)/devicetree.cb"

config EC_STARLABS_ITE_BIN_PATH
	string
	default "3rdparty/blobs/mainboard/\$(MAINBOARDDIR)/\$(CONFIG_VARIANT_DIR)/ec.bin" if \
		BOARD_STARLABS_ADL_SERIES || BOARD_STARLABS_CEZANNE_SERIES || \
		BOARD_STARLABS_STARBOOK_SERIES || BOARD_STARLABS_STARFIGHTER_SERIES

if BOARD_STARLABS_ADL_SERIES || BOARD_STARLABS_STARBOOK_SERIES || \
	BOARD_STARLABS_STARFIGHTER_SERIES

config DIMM_SPD_SIZE
	default 1024 if BOARD_STARLABS_STARBOOK_MTL
	default 512

config FMDFILE
	default "src/mainboard/\$(CONFIG_MAINBOARD_DIR)/variants/\$(CONFIG_VARIANT_DIR)/vboot.fmd" if VBOOT
	default "src/mainboard/\$(CONFIG_MAINBOARD_DIR)/variants/\$(CONFIG_VARIANT_DIR)/board.fmd"

config IFD_BIN_PATH
	string
	default "3rdparty/blobs/mainboard/\$(MAINBOARDDIR)/\$(CONFIG_VARIANT_DIR)/flashdescriptor.bin"

config ME_BIN_PATH
	string
	default "3rdparty/blobs/mainboard/\$(MAINBOARDDIR)/\$(CONFIG_VARIANT_DIR)/intel_me.bin"

config POWER_STATE_DEFAULT_ON_AFTER_FAILURE
	default n

config SOC_INTEL_CSE_SEND_EOP_EARLY
	default n

config USE_PM_ACPI_TIMER
	default n

endif

config STARLABS_MEMORY_SETTINGS_VERSION
	bool
	default y if PLATFORM_USES_FSP2_0 && CACHE_MRC_SETTINGS
	select FSP_PLATFORM_MEMORY_SETTINGS_VERSIONS

menu "Star Labs Settings"

config DAVE_MODE
	bool "Enable DAVE mode"
	select SECURITY_FAIL_CLOSED
	help
	  DAVE mode is the secure, locked-down variant.

config BOOTMEDIA_SMM_BWP
	bool
	default y if SOC_INTEL_COMMON_BLOCK_SMM

config BOOTMEDIA_SMM_BWP_RUNTIME_OPTION
	bool
	default y if SOC_INTEL_COMMON_BLOCK_SMM

config USE_LEGACY_8254_TIMER
	default n if VENDOR_STARLABS

config STARLABS_HAS_I8042_INPUT
	bool
	default y if SYSTEM_TYPE_LAPTOP || SYSTEM_TYPE_DETACHABLE


config DRIVERS_EFI_CAPSULE_REGIONS
	default "FW_MAIN_A RW_FWID_A VBLOCK_A FW_MAIN_B RW_FWID_B VBLOCK_B" if VBOOT_SLOTS_RW_AB && STARLABS_VBOOT_RELEASE_POLICY
	default "EC RW_NVRAM FW_MAIN_A RW_FWID_A VBLOCK_A" if VBOOT && STARLABS_VBOOT_RELEASE_POLICY
	default "COREBOOT EC" if BOARD_STARLABS_ADL_HORIZON || \
		BOARD_STARLABS_STARBOOK_RPL_U || BOARD_STARLABS_STARFIGHTER_MTL

config STARLABS_NO_PCAT_8259
	bool
	default y if BOARD_STARLABS_BYTE_ADL || BOARD_STARLABS_BYTE_TWL
	select NO_PCAT_8259

config ACPI_TPM_TABLES_REQUIRE_PROBE
	bool
	default y if VENDOR_STARLABS

config DRIVERS_EFI_FW_INFO
	def_bool y

config STARLABS_COMMON_POWERCAP
	bool
	default y if SOC_INTEL_COMMON_BLOCK_POWER_LIMIT

config STARLABS_COMMON_CFR
	bool
	default y if CPU_INTEL_COMMON

config SOC_INTEL_COMMON_ACPI_TIME_ALARM
	default y if SOC_INTEL_COMMON_BLOCK_SMM_HAS_WADT

config SOC_INTEL_COMMON_ACPI_TIME_ALARM_S5
	default y if SOC_INTEL_COMMON_ACPI_TIME_ALARM

config STARLABS_AUTOMATIC_START
	def_bool y
	depends on DRIVERS_OPTION_CFR
	depends on SOC_INTEL_COMMON_BLOCK_PMC
	depends on EC_STARLABS_ADAPTER_AUTO_POWER_ON

config DRIVERS_OPTION_CFR_RUNTIME_APPLY
	default y if DRIVERS_OPTION_CFR && USE_UEFI_VARIABLE_STORE

config STARLABS_SMM_OPTION_HANDLER
	select ACPI_SMM_GLOBAL_LOCK
	def_bool y if STARLABS_ACPI_EFI_OPTION_SMI
	default y if DRIVERS_OPTION_CFR_RUNTIME_APPLY
	default y if SOC_INTEL_COMMON_BLOCK_SMM_LOCK_GPIO_PADS && !EDK2_DEBUG

config SOC_INTEL_COMMON_ACPI_RTC_WAKE
	default n if DAVE_MODE

config SOC_INTEL_COMMON_CSE_S0IX
	default n if DAVE_MODE

config STARLABS_LEGACY_PL4
	bool

config STARLABS_TOUCHPAD
	bool
	depends on DRIVERS_I2C_HID

config STARLABS_TOUCHPAD_RUNTIME
	def_bool STARLABS_TOUCHPAD && STARLABS_SMM_OPTION_HANDLER && \
		SOC_INTEL_COMMON_BLOCK_I2C_SMM && USE_UEFI_VARIABLE_STORE

config STARLABS_TOUCHPAD_CONTROLLER
	string

config STARLABS_TOUCHPAD_PIXART
	def_bool STARLABS_TOUCHPAD_CONTROLLER = "pixart"
	select STARLABS_TOUCHPAD

config STARLABS_TOUCHPAD_CST
	def_bool STARLABS_TOUCHPAD_CONTROLLER = "cst"
	select STARLABS_TOUCHPAD

config TCG_OPAL_S3_UNLOCK
	default y

config MB_COMMON_DIR
	string
	default "starlabs/common"

config STARLABS_ACPI_EFI_OPTION_SMI
	bool "Expose coreboot options to ACPI via SMI (UEFI var store)"
	depends on USE_UEFI_VARIABLE_STORE
	depends on HAVE_ACPI_TABLES
	default y
	help
	  Provide ACPI methods that proxy a restricted set of coreboot options
	  (e.g. keyboard backlight and trackpad state) to the UEFI variable
	  store via an SMM APMC SMI handler.

config SOC_INTEL_COMMON_BLOCK_SMM_TCO_INTRUDER_SMI_ENABLE
	default n

source "src/mainboard/starlabs/common/hda/Kconfig"

endmenu

endif
```
