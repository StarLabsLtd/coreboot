## src/drivers/smmstore/Kconfig
```kconfig
## SPDX-License-Identifier: GPL-2.0-only

config SMMSTORE
	bool "Support for flash based, SMM mediated data store"
	depends on BOOT_DEVICE_SUPPORTS_WRITES && HAVE_SMI_HANDLER
	default y if PAYLOAD_EDK2 || PAYLOAD_CRABEFI
	select SPI_FLASH_SMM if BOOT_DEVICE_SPI_FLASH_RW_NOMMAP
	help
	  SMMSTORE allows secure communication with SMM and makes no
	  assumptions on the structure of the data stored within. It splits
	  the store into blocks to allow fault tolerant writes.

if SMMSTORE

config SMMSTORE_SRK_PIN
	bool "Protect the provisioned TPM SRK identity"
	depends on BOOTMEDIA_SMM_BWP && SOC_INTEL_COMMON_BLOCK_SMM
	help
	  Keep the provisioned TPM SRK Name in the protected SRK_PIN_V1 FMAP
	  region. Both ordinary and capsule raw writes exclude its erase blocks.

config SMMSTORE_SRK_PROVISION
	bool "Permit initial SRK pin creation in trusted provisioning firmware"
	depends on SMMSTORE_SRK_PIN
	default n
	help
	  Permit one initial binding on a physically checked board. This image
	  must remain in the trusted provisioning environment. Existing or
	  partially written records cannot be replaced or erased through SMM.

config SMM_AUTHVAR
	bool "SMM-owned authenticated UEFI variables"
	default n
	depends on SOC_INTEL_ALDERLAKE && SMM_TSEG && PAYLOAD_CDK2
	depends on DISABLE_ACPI_HIBERNATE || CDK2_S4_LAYOUT_REQUIRED
	depends on !HAVE_ACPI_RESUME || TSEG_STAGE_CACHE
	depends on BOOTMEDIA_SMM_BWP && !BOOTMEDIA_SMM_BWP_RUNTIME_OPTION
	select SPI_FLASH_SMM
	help
	  Keep the authenticated variable owner and policy in SMRAM. Raw flash
	  mutation through SMMSTORE is unavailable in this composition; firmware
	  updates require a separate authenticated transport. S4 uses the shared
	  fixed communication mailbox and the payload's stable allocation bins.
	  The native protected update transport does not support vboot's split
	  firmware regions. Vboot builds must retain the ordinary SMMSTORE owner.

config PAYLOAD_MM_AUTHVAR_SERVICE_ROUTE_ATTESTED
	bool
	default y if SMM_AUTHVAR

config SMMSTORE_SIZE
	hex "size of the SMMSTORE FMAP region"
	default 0x80000
	help
	  Sets the size of the default SMMSTORE FMAP region.
	  If using an UEFI payload, note that UEFI specifies at least 64K.
	  Fault-tolerant UEFI variable stores typically need multiple
	  blocks (often at least 256K with 64K blocks), so prefer a
	  rather large value.

config SMMSTORE_BLOCK_SIZE
	int
	default 65536
	help
	  Sets the logical block size used by the SMMSTORE protocol. This is
	  an internal SoC or board policy value, not a user-visible option.

endif
```
