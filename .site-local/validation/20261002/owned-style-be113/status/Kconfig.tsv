## src/lib/Kconfig
```kconfig
## SPDX-License-Identifier: GPL-2.0-only

config MISSING_BOARD_RESET
	bool
	help
	  Selected by boards that don't provide a do_board_reset()
	  implementation. This activates a stub that logs the missing
	  board reset and halts execution.

config BOOTMEM_DRAM_PROVENANCE
	bool
	default n
	help
	  Retain the cacheable memory resources owned by enabled device domains
	  and expose their exact intersections with final bootmem ownership tags.
	  This adds no consumer, boot hook or memory-clear support claim.

config BOOTMEM_ALIGNED_RESERVATIONS
	bool
	default n
	help
	  Allow dormant clients to register a bounded set of exact, aligned DRAM
	  reservations before bootmem initialization. All requests are resolved
	  atomically from final RAM ownership before the OS memory table is written.
	  This option registers no request and installs no platform hook.

config PAYLOAD_MM_AUTHVAR_MOR_LIVE_INVENTORY
	bool
	default n
	select BOOTMEM_DRAM_PROVENANCE
	select PAYLOAD_MM_AUTHVAR_MOR_CLEAR_PLAN
	help
	  Build the dormant allocation-free memory-clear inventory composer.
	  This adds no boot hook, clear operation, endpoint or support claim.

config PAYLOAD_RESOURCE_HANDOFF
	bool "Publish assigned PCI resources to the payload"
	default n
	depends on PCI && ECAM_MMCONF_SUPPORT
	help
	  Serialize PCI root topology and exact coreboot-assigned resources for
	  payloads that consume the resource handoff. Revision 3 remains the safe
	  default; boards with a trustworthy PCI tree and boot-controller policy
	  may opt in to revision 4 topology and boot-intent sections. Before the
	  record is published, bus mastering is disabled and verified for every
	  serialized function. A platform must explicitly provide trustworthy
	  revision-4 topology and boot-controller policy before that revision is
	  published.

config PAYLOAD_DMA_HANDOFF
	bool
	depends on PAYLOAD_RESOURCE_HANDOFF
	help
	  Publish a versioned reference to a bounded, platform-prepared DMA
	  protection description. The record is rejected unless a platform
	  revision-4 resource handoff was successfully published and the supplied
	  protection state is complete. This preparatory interface does not enroll
	  controllers, expose a payload IOMMU protocol, or enable bus mastering.

config CAPSULE_UPDATE_CONTRACT
	bool
	default n
	help
	  Build the capsule handoff validator and private verified bounded-region
	  writer prerequisite. This does not build a producer, publish a coreboot
	  table record or register a payload-callable flash broker.

config PAYLOAD_MM_AUTHVAR_CONTRACT
	bool
	default n
	depends on BOOT_DEVICE_SUPPORTS_WRITES && HAVE_SMI_HANDLER
	help
	  Build the dormant coreboot/Payload-MM authenticated-variable boundary.
	  This validates platform-owned SMM, communication-buffer and variable-store
	  geometry, but does not install an MM dispatcher, publish a service or grant
	  raw flash access. The compiled SMM object also contains unselected typed
	  SystemFmp state parsing, protected staging and a fixed typed variable-owner
	  port. It provides no identity producer, operation executor, variable backend
	  or persistence claim. A platform must select this together with a matched
	  native payload and provide the missing SMM/SPI ownership hooks.

config PAYLOAD_MM_AUTHVAR_STORE_SCANNER
	bool
	default n
	help
	  Build the read-only authenticated-variable store scanner, bounded
	  caller-owned index and allocation-free exact-key lookup. This does not
	  publish a service, install an SMI endpoint or provide any variable-store
	  write path.

config PAYLOAD_MM_AUTHVAR_FTW_DECODER
	bool
	default n
	depends on PAYLOAD_MM_AUTHVAR_STORE_SCANNER
	help
	  Build the read-only EDK2 26.09 FV/FTW geometry decoder and recovery-state
	  planner. It exposes no flash callbacks, mutation path, service or endpoint.

config PAYLOAD_MM_AUTHVAR_STORE_SEMANTICS
	bool
	default n
	depends on PAYLOAD_MM_AUTHVAR_STORE_SCANNER
	help
	  Build the read-only GET, NEXT and QUERY semantic helpers and deterministic
	  append-or-reclaim planner. It does not copy results into shared memory,
	  mutate media, execute an FTW plan, or publish a service endpoint.

config PAYLOAD_MM_AUTHVAR_VOLATILE_VIEW
	bool
	default n
	depends on PAYLOAD_MM_AUTHVAR_STORE_SEMANTICS
	help
	  Build the pure immutable EDK2 26.09 volatile-variable view. It projects
	  five synthetic read-only values ahead of persistent variables without
	  creating store records, accessing media or publishing a service endpoint.

config PAYLOAD_MM_AUTHVAR_DEFAULT_STORE
	bool
	default n
	depends on PAYLOAD_MM_AUTHVAR_FTW_DECODER
	depends on PAYLOAD_MM_AUTHVAR_STORE_SEMANTICS
	help
	  Build the dormant pure EDK2 26.09 SetupMode default-store composer.
	  It creates and classifies protected candidate bytes, but performs no
	  media operation, recovery, service dispatch or endpoint publication.

config PAYLOAD_MM_AUTHVAR_MEDIA_PORT
	bool
	default n
	depends on PAYLOAD_MM_AUTHVAR_CONTRACT && PAYLOAD_MM_AUTHVAR_STORE_SCANNER
	depends on PAYLOAD_MM_AUTHVAR_FTW_DECODER
	depends on PAYLOAD_MM_AUTHVAR_STORE_SEMANTICS
	help
	  Build the dormant SMM-only authenticated-variable media port. It seals a
	  platform backend against the validated SMMSTORE contract and provides
	  bounded reads plus verified NOR program and single-block erase primitives.
	  The supported erase block must fit the 4 KiB protected snapshot capacity.
	  This adds no writer, FTW executor, dispatcher, endpoint or publication.

config PAYLOAD_MM_AUTHVAR_WRITER
	bool
	default n
	depends on PAYLOAD_MM_AUTHVAR_MEDIA_PORT
	help
	  Build the dormant authenticated-variable record and mutation planner. It
	  emits canonical records and ordered state transitions, but performs no
	  media operation. Reclaim and every plan execution remain the responsibility
	  of the later FTW executor.

config PAYLOAD_MM_AUTHVAR_EXECUTOR
	bool
	default n
	depends on PAYLOAD_MM_AUTHVAR_WRITER
	help
	  Build the dormant SMM-only authenticated-variable executor. It owns a
	  sealed protected arena, bounded FTW recovery and exact writer-plan
	  execution without exposing raw media coordinates or a service endpoint.

config PAYLOAD_MM_AUTHVAR_DEFAULT_STORE_RECOVERY
	bool
	default n
	depends on PAYLOAD_MM_AUTHVAR_EXECUTOR
	depends on PAYLOAD_MM_AUTHVAR_DEFAULT_STORE
	help
	  Build the dormant same-lease erased-media bootstrap prerequisite. It
	  monotonically programs the canonical default store before lifecycle freeze
	  and then enters the existing FTW recovery path. It publishes no backend,
	  dispatcher, service or endpoint.

config PAYLOAD_MM_AUTHVAR_FORMAT_PARSER
	bool
	default n
	depends on PAYLOAD_MM_AUTHVAR_EXECUTOR
	help
	  Build the dormant SMM-only Auth2 envelope and EFI signature-list parser.
	  It performs bounded byte-wise decoding only and supplies no cryptography,
	  trust policy, mutation authority, dispatcher or service endpoint.

config PAYLOAD_MM_AUTHVAR_SIGNATURE_DB
	bool
	default n
	depends on PAYLOAD_MM_AUTHVAR_FORMAT_PARSER
	select PAYLOAD_MM_CMS_CORE
	help
	  Build the dormant protected-snapshot Secure Boot signature-database
	  semantic validator and allocation-free append filter. It validates every
	  X.509 certificate with the bounded crypto arena, but grants no trust,
	  authorization, store mutation, provider or endpoint.

config PAYLOAD_MM_AUTHVAR_CERTDB
	bool
	default n
	help
	  Build the dormant allocation-free EDK2 26.09 private authenticated-variable
	  certdb codec. It validates complete packed snapshots and composes bounded
	  add or remove replacements, but performs no cryptography, authorization,
	  store mutation, media operation, provider or endpoint publication.

config PAYLOAD_MM_AUTHVAR_ROUTE
	bool
	default n
	depends on PAYLOAD_MM_AUTHVAR_FORMAT_PARSER
	help
	  Build the dormant allocation-free authenticated-variable authorization
	  router. It classifies protected request snapshots and emits ordered PK,
	  KEK, payload-certificate or certdb authorities and post-success intent,
	  but performs no trust, replay, payload-format or mutation decision.

config PAYLOAD_MM_AUTHVAR_TRUST_STORE
	bool
	default n
	depends on PAYLOAD_MM_AUTHVAR_STORE_SCANNER
	depends on PAYLOAD_MM_AUTHVAR_FORMAT_PARSER
	depends on PAYLOAD_MM_AUTHVAR_SIGNATURE_DB
	depends on PAYLOAD_MM_AUTHVAR_ROUTE
	depends on PAYLOAD_MM_AUTHVAR_TRUST_ANCHOR
	help
	  Build the dormant protected-store PK/KEK trust-policy matcher. It consumes
	  only an immutable scanner-produced index and canonical user-mode route,
	  but performs no Auth2, replay, payload or mutation decision.

config PAYLOAD_MM_AUTHVAR_PRIVATE_BINDING
	bool
	default n
	depends on PAYLOAD_MM_AUTHVAR_CMS_VERIFY
	help
	  Build the dormant EDK2 26.09 private authenticated-variable signer-binding
	  derivation and matcher. It consumes only immutable verified-CMS views and
	  opaque certdb binding bytes, and performs no trust, certdb mutation,
	  variable authorization, media operation or endpoint publication.

config PAYLOAD_MM_AUTHVAR_PRIVATE_TRUST
	bool
	default n
	depends on PAYLOAD_MM_AUTHVAR_STORE_SCANNER
	depends on PAYLOAD_MM_AUTHVAR_CERTDB
	depends on PAYLOAD_MM_AUTHVAR_ROUTE
	depends on PAYLOAD_MM_AUTHVAR_PRIVATE_BINDING
	help
	  Build the dormant EDK2 26.09 private authenticated-variable signer-trust
	  decision. It verifies detached CMS against a strict certdb binding, or
	  derives a new binding, but performs no store mutation, media operation,
	  authorization composition, provider or endpoint publication.

config PAYLOAD_MM_AUTHVAR_AUTHORITY
	bool
	default n
	depends on PAYLOAD_MM_AUTHVAR_EXECUTOR
	depends on PAYLOAD_MM_AUTHVAR_SIGNATURE_DB
	depends on PAYLOAD_MM_AUTHVAR_ROUTE
	help
	  Build the dormant allocation-free Auth2 policy authority. It consumes one
	  immutable protected store snapshot, emits one canonical target mutation
	  and typed derived-state intents, but installs no provider or endpoint and
	  performs no store or media operation. A later atomic multi-variable
	  composer is required before this authority may be selected for service.

config PAYLOAD_MM_AUTHVAR_BUNDLE_PLAN
	bool
	default n
	depends on PAYLOAD_MM_AUTHVAR_AUTHORITY
	select PAYLOAD_MM_AUTHVAR_CERTDB
	select PAYLOAD_MM_AUTHVAR_VOLATILE_VIEW
	help
	  Build the dormant fixed-role atomic bundle planner. It expands one final
	  Auth2 authority outcome into target, persistent certdb,
	  SecureBootEnable and VendorKeysNv mutations plus a packed volatile mode
	  projection. It writes no media, creates no candidate image and installs no
	  provider or endpoint.

config PAYLOAD_MM_AUTHVAR_CANDIDATE
	bool
	default n
	depends on PAYLOAD_MM_AUTHVAR_BUNDLE_PLAN
	help
	  Build the dormant pure authenticated-variable whole-store candidate
	  composer. It independently rescans the source, verifies any paired target
	  and persistent-certdb transition, and emits one canonical, provenance-bound
	  replacement image. It performs no media operation, installs no provider
	  and publishes no endpoint.

config PAYLOAD_MM_AUTHVAR_CANDIDATE_COMMIT
	bool
	default n
	depends on PAYLOAD_MM_AUTHVAR_CANDIDATE
	help
	  Build the dormant same-lease whole-store candidate commit prerequisite.
	  It admits a provenance-bound candidate under the active media generation
	  and token, then uses the existing EDK2-compatible FTW state machine. It
	  installs no backend or provider and publishes no endpoint.

config PAYLOAD_MM_AUTHVAR_COORDINATOR
	bool
	default n
	depends on PAYLOAD_MM_AUTHVAR_CANDIDATE_COMMIT
	select PAYLOAD_MM_AUTHVAR_CONTROLLED_MODE
	help
	  Build the dormant authenticated-variable coordinator. It derives every
	  mode fact from the active protected store and sealed executor lifecycle,
	  then performs authority, fixed-role bundle, whole-store composition and
	  same-lease commit in one linear transaction. It installs no provider and
	  publishes no endpoint.

config PAYLOAD_MM_AUTHVAR_AUTHORITY_PROVIDER
	bool
	default n
	depends on PAYLOAD_MM_AUTHVAR_COORDINATOR
	depends on !PAYLOAD_MM_AUTHVAR_REQUIRE_SELF_SIGNED_PK
	depends on PAYLOAD_MM_AUTHVAR_TRUST_STORE
	depends on PAYLOAD_MM_AUTHVAR_PRIVATE_TRUST
	help
	  Build the dormant concrete authority verifier used by the authenticated-
	  variable coordinator. It selects protected PK/KEK or private signer trust
	  from the canonical route and normalizes private authentication failures,
	  but installs no endpoint and performs no media operation.

config PAYLOAD_MM_AUTHVAR_CONTROLLED_MODE
	bool
	default n
	depends on PAYLOAD_MM_AUTHVAR_BUNDLE_PLAN
	help
	  Build the dormant EDK2 26.09-derived, fail-closed SecureBootEnable and
	  CustomMode policy.
	  It enforces their fixed property and trusted physical-presence gates, but
	  performs no store or media operation and publishes no endpoint.

config PAYLOAD_MM_AUTHVAR_MOR_POLICY
	bool
	default n
	help
	  Build the dormant EDK2 26.09-derived secure memory-overwrite-request
	  policy planner. It publishes no endpoint. Support and lifecycle facts are
	  protected snapshots from trusted coreboot code, never request fields or
	  build arguments.

config PAYLOAD_MM_AUTHVAR_MOR_ENTRY_PROBE
	bool
	default n
	select SMMSTORE_READ_REGION
	help
	  Build the dormant ramstage read-only probe for the canonical entry MOR
	  Control value in a clean EDK2 variable store, with private ramstage copies
	  of the pure FV/FTW decoder and store scanner. A future composition must
	  invoke it only after preparing the platform DMA guard and establishing a
	  trusted cold-boot classification. This does not add a caller, produce a
	  boot generation, clear memory, establish platform support, build an SMM
	  path, install a grant or publish an endpoint.

config PAYLOAD_MM_AUTHVAR_MOR_COMPLETION_GRANT
	bool
	default n
	depends on HAVE_SMI_HANDLER
	help
	  Build a dormant fixed completion-receipt validator and one-shot protected
	  SMM install-or-close authority. This supplies no producer, transport,
	  endpoint or MOR support claim; receipt fields are assertions until a
	  trusted producer is separately composed.

config PAYLOAD_MM_AUTHVAR_MOR_COMPLETION_SEAL
	bool
	default n
	depends on HAVE_SMI_HANDLER
	select PAYLOAD_MM_AUTHVAR_MOR_COMPLETION_GRANT
	help
	  Build a dormant private fixed-channel adapter that can install or close
	  the protected MOR completion grant exactly once. A platform must compose
	  its own authenticated SMM trigger and independently observed caller facts.
	  This adds no APM/SMMSTORE endpoint, boot hook, or MOR support claim.

config PAYLOAD_MM_AUTHVAR_MOR_CLEAR_PLAN
	bool
	default n
	help
	  Build the stage-neutral canonical memory-clear plan builder and validator.
	  This adds no clear executor, completion receipt, SMM dependency, boot hook,
	  endpoint, or MOR support claim.

config PAYLOAD_MM_AUTHVAR_MOR_CLEAR_RECEIPT
	bool
	default n
	depends on PAYLOAD_MM_AUTHVAR_MOR_COMPLETION_GRANT
	select PAYLOAD_MM_AUTHVAR_MOR_CLEAR_PLAN
	help
	  Build a dormant pure canonical clear-plan and completion-receipt builder.
	  It performs no clear, readback, cache operation or DMA transition and adds
	  no producer, endpoint or MOR support claim.

config PAYLOAD_MM_AUTHVAR_MOR_CLEAR_EXECUTOR
	bool
	default n
	depends on PAYLOAD_MM_AUTHVAR_MOR_CLEAR_RECEIPT
	help
	  Build the dormant, platform-neutral bounded memory-clear executor.
	  This adds no boot hook and makes no platform-support claim. A future
	  platform integration must provide reviewed mapping, cache, fence, and
	  DMA-policy snapshot operations.

config PAYLOAD_MM_AUTHVAR_MOR_CLEAR_X86_BACKEND
	bool
	default n
	depends on ARCH_X86 && PAYLOAD_MM_AUTHVAR_MOR_CLEAR_EXECUTOR
	help
	  Build a dormant generic x86 PAE mapping and cache-maintenance backend for
	  the MOR clear executor. It allocates nothing, installs no boot hook and
	  makes no platform-support claim. A platform must supply excluded page-table
	  backing and a reserved fixed virtual aperture.

config PAYLOAD_MM_AUTHVAR_REQUIRE_SELF_SIGNED_PK
	bool
	default n
	help
	  Require a new platform key enrolled through CustomMode physical-presence
	  bypass to be self-signed. This matches EDK2's disabled default.

config CAPSULE_BROKER_CONTRACT
	bool
	default n
	depends on CAPSULE_UPDATE_CONTRACT && PAYLOAD_MM_AUTHVAR_CONTRACT
	help
	  Build the dormant one-shot SMM capsule-broker contract. This adds no
	  producer, table publication, SMI entry or production flash
	  backend or selected payload service. It includes an unselected typed port
	  which uses the protected SystemFmp owner to issue a checkpoint grant only
	  after the owner's atomic backend commits and reads back the exact failure
	  state. It also admits a separate, fixed authenticated-capsule CHECK/SET
	  intent into protected staging and a sealed authentication-provider port;
	  generic state writes cannot imply SET. An unselected synchronous executor
	  keeps dispatch busy across authentication, exact owner-state checkpoint
	  and broker APPLY. A fixed pointer-free transport can call only that staged
	  executor or return sealed read-only image information, but remains
	  unreachable without a platform SMI entry. INFO has no platform policy
	  producer. A future platform must still provide the backend,
	  protected policy producer, DMA-isolated staging and complete close-before-
	  external-code lifecycle.

config CAPSULE_BROKER_FIXED_BUFFERS
	bool
	default n
	depends on CAPSULE_BROKER_CONTRACT
	help
	  Reserve fixed communication and staging memory from coreboot's resource
	  map and provide fixed protected SMM scratch. This establishes allocation,
	  lifetime and non-overlap only. It does not establish DMA isolation,
	  install a broker or publish an endpoint.

config CAPSULE_BROKER_CBMEM_BUFFERS
	bool
	default n
	depends on CAPSULE_BROKER_FIXED_BUFFERS
	help
	  Allocate the communication and staging reservations as independent,
	  early CBMEM entries. This removes any requirement that either reservation
	  be adjacent to SMRAM or CBMEM top. The platform staging-size provider must
	  be linked in the CBMEM-creating stage and ramstage. No platform selects
	  this option here.

config CAPSULE_BROKER_ENDPOINT_PUBLICATION
	bool
	default n
	depends on CAPSULE_BROKER_FIXED_BUFFERS && ARCH_X86 && HAVE_SMI_HANDLER
	depends on DRIVERS_EFI_FW_INFO
	help
	  Build the dormant, readiness-gated capsule SMI route and coreboot-table
	  endpoint publisher. A future platform must bind the exclusive APM route,
	  install the complete broker policy and prove it ready before publication.
	  No platform selects this option or supplies that composition here.

config CAPSULE_PLATFORM_FACTS
	bool
	default n
	depends on CAPSULE_BROKER_FIXED_BUFFERS
	depends on DRIVERS_EFI_FW_INFO && BOOT_DEVICE_SPI_FLASH
	depends on ARCH_X86
	help
	  Build the dormant one-shot collector for pointer-free capsule platform
	  facts. It reads the real FMAP and SPI boot-media geometry and records the
	  fixed buffers, two erase-block SMM scratch buffers and firmware identity.
	  It derives no writable routes, installs no authority and publishes no
	  table. No platform selects this option.

config CAPSULE_PLATFORM_ADAPTERS
	bool
	default n
	depends on CAPSULE_PLATFORM_FACTS
	depends on SPI_FLASH_SMM
	help
	  Build dormant adapters from the protected capsule facts to the real SPI
	  boot-device transport, exact SMRAM containment and firmware/mainboard
	  identity policies. These adapters deliberately provide no DMA, SMM-only
	  SPI, raw-flash exclusion, rendezvous, journal, trust-root or route proof.
	  No platform selects this option.

config CAPSULE_TPM_ANCHOR_GRANT
	bool
	default n
	depends on TPM2 && PAYLOAD_MM_AUTHVAR_CONTRACT
	help
	  Build the dormant split-transaction ABI for passing one exact TPM-backed
	  rollback-anchor transition from a pre-OS TPM owner into protected SMM
	  storage. It also builds the compatible owner-journal PREPARED sidecar and
	  exact one-shot reconciliation path. This supplies no authorization
	  material, TPM mutation, SMI route or platform selection.

config CAPSULE_TPM_ANCHOR_TRANSITION
	bool
	default n
	depends on CAPSULE_TPM_ANCHOR_GRANT && CAPSULE_UPDATE_CONTRACT && ARCH_X86
	help
	  Build the dormant pre-OS rollback-anchor transition coordinator and its
	  bounded, read-only owner-journal PREPARED proof reader. No platform
	  selects this option and no TPM provider is included. The reader accepts
	  only an immutable current-anchor snapshot and two bounded state devices.
	  A future provider must execute separately authorized replacement-write
	  and write-lock operations, then return authoritative public state and
	  value readback. This adds no SMM grant route or platform selection.

config CAPSULE_TPM_ANCHOR_POLICY_PROVIDER
	bool
	default n
	depends on CAPSULE_TPM_ANCHOR_TRANSITION
	help
	  Build the dormant TPM 2.0 policy provider for the rollback-anchor
	  transition. It checks separate PolicyAuthorize material for the complete
	  replacement write and write lock and returns authoritative readback.
	  The larger stack requirement covers the coordinator, immutable operation
	  snapshot, TPM policy command encoders and platform transport call chain.
	  No platform selects this option, supplies authorization material, installs
	  a grant or publishes an SMI endpoint.

config TPM2_FIFO_PRE_OS_LIFECYCLE
	bool
	default n
	depends on TPM2 && MEMORY_MAPPED_TPM && ARCH_X86
	depends on !CRB_TPM && !AMD_CRB_FTPM && !I2C_TPM && !SPI_TPM
	help
	  Transfer an initialized TPM 2.0 FIFO transport from the legacy TSS to
	  one late-ramstage lifecycle owner. The transfer is one-shot: it revokes
	  the legacy route before installing the owner and never restores it.
	  This supplies no TPM policy, capsule provider, SMM route or endpoint.

config TPM2_PLATFORM_AUTH_CODECS
	bool
	default n
	depends on TPM2_FIFO_PRE_OS_LIFECYCLE
	help
	  Build dormant strict TPM2 platform-authorized NV write, NV write-lock,
	  platform-hierarchy close and startup-clear verification codecs over the
	  exclusive pre-OS lifecycle transport. No platform selects or invokes
	  these codecs. Late mutable firmware remains a weaker TCB than an earlier
	  hardware-enforced root; closing phEnable makes no stronger claim.

config CAPSULE_TPM_ANCHOR_TRUSTED_TRANSITION
	bool
	default n
	depends on CAPSULE_TPM_ANCHOR_TRANSITION && TPM2_PLATFORM_AUTH_CODECS
	help
	  Build the dormant policy-revision-3 platform-authorized rollback-anchor
	  transition. This supplies no platform selection, provider, resume path,
	  SMI route, provisioning or runtime DMA proof. Late mutable firmware
	  remains a weaker TCB than an earlier hardware-enforced root.

config PAYLOAD_MM_CMS_CORE
	bool
	default n
	help
	  Build the dormant SMM-safe bounded DER, CMS, RSA and X.509 verification
	  core. This supplies no trust-policy producer, provider, endpoint or route.

config PAYLOAD_MM_CMS_VERIFY
	bool
	default n
	depends on CAPSULE_BROKER_CONTRACT
	select PAYLOAD_MM_CMS_CORE
	help
	  Build the dormant SMM-safe authenticated-capsule verification core. It
	  accepts bounded canonical DER/CMS with RSA/SHA-256 X.509 chains and uses
	  a fixed protected arena which is wiped after every call. It also builds an
	  unselected protected SystemFmp authentication-policy owner and capsule-
	  broker provider. This selects no policy producer, SMI entry or flash
	  backend. A platform must seal its trust roots, image
	  identity, board identity and version floor before installing it.

config PAYLOAD_MM_AUTHVAR_CMS_VERIFY
	bool
	default n
	depends on PAYLOAD_MM_AUTHVAR_FORMAT_PARSER
	select PAYLOAD_MM_CMS_CORE
	help
	  Build the dormant untrusted detached-CMS verifier for authenticated
	  variables. It verifies bounded RSA/SHA-256, SHA-384 or SHA-512 CMS
	  mechanics and exposes input-backed signer views, but makes no trust,
	  variable-policy or authorization decision and publishes no endpoint.

config PAYLOAD_MM_AUTHVAR_TRUST_ANCHOR
	bool
	default n
	depends on PAYLOAD_MM_AUTHVAR_CMS_VERIFY
	help
	  Build the dormant authenticated-variable X.509 trust-anchor matcher. It
	  checks strict CMS-backed signer views against one caller-supplied current
	  PK or KEK certificate, but selects no store entry, policy, route or
	  endpoint and grants no mutation authority.

config ROMSTAGE_ADA
	bool
	help
	  Selected by features that use Ada code in romstage.

config RAMSTAGE_ADA
	bool
	help
	  Selected by features that use Ada code in ramstage.

config RAMSTAGE_LIBHWBASE
	bool
	select RAMSTAGE_ADA
	help
	  Selected by features that require `libhwbase` in ramstage.

config ROMSTAGE_LIBHWBASE
	bool
	select ROMSTAGE_ADA
	help
	  Selected by features that require `libhwbase` in romstage.

config FLATTENED_DEVICE_TREE
	bool
	help
	  Selected by features that require to parse and manipulate a flattened
	  devicetree in ramstage.

config HAVE_SPD_IN_CBFS
	bool
	help
	  If enabled, add support for adding spd.hex files in cbfs as spd.bin
	  and locating it runtime to load SPD.

config DIMM_MAX
	int
	default 4
	help
	  Total number of memory DIMM slots available on motherboard.
	  It is multiplication of number of channel to number of DIMMs per
	  channel

config MAX_SOCKET
	int
	default 1

config DIMM_SPD_SIZE
	int
	default 256
	help
	  Total SPD size that will be used for DIMM.
	  Ex: DDR3 256, DDR4 512.

config SPD_READ_BY_WORD
	bool

config SPD_CACHE_IN_FMAP
	bool
	default n
	help
	  Enables capability to cache DIMM SPDs in a dedicated FMAP region
	  to speed loading of SPD data. Currently requires board-level
	  romstage implementation to read/write/utilize cached SPD data.
	  When the default FMAP is used, will create a region named RW_SPD_CACHE
	  to store the cached SPD data.

config SPD_CACHE_FMAP_NAME
	string
	depends on SPD_CACHE_IN_FMAP
	default "RW_SPD_CACHE"
	help
	  Name of the FMAP region created in the default FMAP to cache SPD data.

config SPD_CACHE_TPM_HASH
	bool
	default n
	depends on SPD_CACHE_IN_FMAP
	select TPM
	help
	  Enables storing a SHA-256 hash of the cached SPD data in a TPM NVRAM
	  index (0x1010) whenever the RW_SPD_CACHE region is updated.

	  During boot, coreboot verifies the RW_SPD_CACHE against the digest
	  stored in the TPM. If the hashes do not match (e.g. due to RW SPI
	  tampering), coreboot invalidates the cache and falls back to a fresh
	  MRC training.

if RAMSTAGE_LIBHWBASE && !ROMSTAGE_LIBHWBASE

config HWBASE_DYNAMIC_MMIO
	def_bool y

endif

if ROMSTAGE_LIBHWBASE

config HWBASE_STATIC_MMIO
	def_bool y

endif

if RAMSTAGE_LIBHWBASE || ROMSTAGE_LIBHWBASE

config HWBASE_DEFAULT_MMCONF
	hex
	default ECAM_MMCONF_BASE_ADDRESS

config HWBASE_DIRECT_PCIDEV
	def_bool y

endif

config NO_FMAP_CACHE
	bool
	help
	  If your platform really doesn't want to use an FMAP cache (e.g. due to
	  space constraints), you can select this to disable warnings and save
	  a bit more code.

config ESPI_DEBUG
	bool
	help
	  This option enables eSPI library helper functions for displaying debug
	  information.

config NO_CBFS_MCACHE
	bool
	help
	  Disables the CBFS metadata cache. This means that your platform does
	  not need to provide a CBFS_MCACHE section in memlayout and can save
	  the associated CAR/SRAM size. In that case every single CBFS file
	  lookup must re-read the same CBFS directory entries from flash to find
	  the respective file.

config CBFS_CACHE_ALIGN
	int
	default 8
	help
	  Sets the alignment of the buffers returned by the cbfs_cache.

config CBFS_PRELOAD
	bool
	depends on COOP_MULTITASKING
	help
	  When enabled it will be possible to preload CBFS files into the
	  cbfs_cache. This helps reduce boot time by loading the files
	  in the background before they are actually required. This feature
	  depends on the read-only boot_device having a DMA controller to
	  perform the background transfer.

config DECOMPRESS_OFAST
	bool
	depends on COMPILER_GCC
	default y
	help
	  Compile the decompressing function in -Ofast instead of standard -Os

config PROBE_RAM
	def_bool y if VENDOR_EMULATION
	help
	  When enabled it will be possible to detect usable RAM using probe_ram
	  function.

menu "Boot Logo Configuration"

config BMP_LOGO
	bool "Enable logo"
	default n
	help
	  Displays a BMP logo during boot. This method supports a
	  BMP file only. The uncompressed size can be up to 1 MB. The logo can
	  be compressed based on either `BMP_LOGO_COMPRESS_*` configs (default LZMA).

config HAVE_CUSTOM_BMP_LOGO
	def_bool n
	depends on BMP_LOGO

config HAVE_BMP_LOGO_COMPRESS_LZMA
	bool
	depends on BMP_LOGO
	default y

choice
	prompt "BMP Logo compression"
	depends on BMP_LOGO
	default BMP_LOGO_COMPRESS_LZMA if HAVE_BMP_LOGO_COMPRESS_LZMA
	default BMP_LOGO_COMPRESS_LZ4

config BMP_LOGO_COMPRESS_LZMA
	bool "Use LZMA compression for BMP logo"
	help
	  This option enables the use of LZMA compression for the BMP logo.
	  LZMA is a lossless compression algorithm that can significantly reduce
	  the size of the logo, without sacrificing quality.

	  If this option is not enabled, the BMP logo will be uncompressed.

config BMP_LOGO_COMPRESS_LZ4
	bool "Compress BMP logo using LZ4"
	help
	  This option enables compression of the BMP logo using the LZ4 algorithm.
	  Although the size reduction is not as efficient as LZMA compression, however,
	  it can also make the boot process slightly faster compared to the LZMA.

endchoice

config BMP_LOGO_FILE_NAME
	string "Logo file"
	depends on BMP_LOGO
	default "3rdparty/blobs/mainboard/\$(MAINBOARDDIR)/logo.bmp"

config ENABLE_ESOL
	def_bool FSP_UGOP_EARLY_SIGN_OF_LIFE || MAINBOARD_USE_EARLY_LIBGFXINIT
	help
	  Early sign-of-life (eSOL) provides an early boot notification
	  during long-running firmware operations such as memory training
	  and firmware updates requiring a restart (e.g., CSE and FSP).

	  eSOL Implementation Options:

	  - FSP uGOP: Closed-source solution from Intel's Firmware Support
	  Package.
	  - libgfxinit: Open-source graphics initialization library.

	  Platforms before Intel Meteor Lake are expected to use the libgfxinit.

	  Devices from Intel Meteor Lake onwards will utilize the Intel FSP
	  uGOP driver for eSOL.

	  If your platform supports eSOL, enable it by selecting the
	  appropriate option.

config HAVE_ESOL_SUPPORT_FOR_LOW_BATTERY_INDICATOR
	bool
	depends on ENABLE_ESOL
	help
	  Enable low-battery indicator support in eSOL.

	  This option should be selected if the eSOL feature (using either libgfxinit or FSP uGOP)
	  supports displaying a low-battery indicator.

	  Platforms selecting `MAINBOARD_HAS_EARLY_LIBGFXINIT` can default enable this option.

	  For platforms using FSP uGOP, this option should only be enabled if uGOP has implemented
	  the necessary low-battery handling. This allows platforms to control low-battery
	  indicator support based on uGOP readiness.

config PLATFORM_HAS_LOW_BATTERY_INDICATOR
	bool "Display low battery indicator"
	depends on BMP_LOGO
	help
	  If enabled, this option displays a low battery indicator screen. This screen can be
	  used to warn the user that the battery is low and that they should plug in the device.

	  This option requires that the system have a display and that the BMP_LOGO option is
	  enabled.

config PLATFORM_POST_RENDER_DELAY_SEC
	int
	default 5
	help
	  Delay, in seconds, after rendering a splash screen element.
	  In low-battery mode, this ensures the warning is visible before shutdown.
	  In normal modes, this can be used to ensure the display has finished
	  teardown/synchronization after user notification before passing control
	  to the OS.

config PLATFORM_HAS_SECONDARY_BOOT_INDICATOR_LOGO
	bool "Enable alternative (Secondary) resolution for boot indicator"
	default n
	help
	  Select this if your board uses multiple panels with different
	  resolutions and needs a second set of indicator logos in CBFS.

if PLATFORM_HAS_LOW_BATTERY_INDICATOR

config PLATFORM_HAS_EARLY_LOW_BATTERY_INDICATOR
	bool "Display low battery indicator in romstage"
	depends on HAVE_ESOL_SUPPORT_FOR_LOW_BATTERY_INDICATOR
	help
	  If enabled, this option displays a low battery indicator during romstage (before memory
	  is available) in text mode in the firmware and defer the firmware update. This screen
	  can be used to warn the user that the battery is low and that they should plug in the
	  device.

config PLATFORM_LOW_BATTERY_INDICATOR_LOGO_PATH
	string "Path to low battery logo file"
	default "3rdparty/blobs/mainboard/\$(MAINBOARDDIR)/low_battery.bmp"

if PLATFORM_HAS_SECONDARY_BOOT_INDICATOR_LOGO

config PLATFORM_LOW_BATTERY_INDICATOR_LOGO_SECONDARY_PATH
	string "Path to secondary low battery logo"
	default "3rdparty/blobs/mainboard/\$(MAINBOARDDIR)/low_battery_alt.bmp"

endif # PLATFORM_HAS_SECONDARY_BOOT_INDICATOR_LOGO
endif # PLATFORM_HAS_LOW_BATTERY_INDICATOR

config SPLASH_SCREEN_FOOTER
	bool "Enable custom footer on firmware splash screen"
	depends on BMP_LOGO
	help
	  Enable this option to display a custom footer image or logo on the
	  firmware splash screen during the boot process. This provides an
	  additional branding opportunity for device manufacturers, allowing
	  them to display a logo or other graphic at the bottom of the
	  splash screen, complementing the main OEM splash image.

config SPLASH_SCREEN_FOOTER_LOGO_PATH
	string "Path to splash screen footer logo file"
	depends on SPLASH_SCREEN_FOOTER
	default "3rdparty/blobs/mainboard/\$(MAINBOARDDIR)/logo.bmp"

config PLATFORM_HAS_OFF_MODE_CHARGING_INDICATOR
	bool "Display off-mode charging indicator"
	default n
	depends on BMP_LOGO
	help
	  Enable an off-mode charging splash screen to notify the user that
	  the device is charging. This prevents user confusion when a
	  device autoboots into a charging state upon the
	  insertion of a power cable, rather than performing a full OS boot.

	  This feature requires a functional display and depends on the
	  BMP_LOGO infrastructure to render the charging assets.

if PLATFORM_HAS_OFF_MODE_CHARGING_INDICATOR

config PLATFORM_OFF_MODE_CHARGING_INDICATOR_LOGO_PATH
	string "Path to off-mode charging logo file"
	default "3rdparty/blobs/mainboard/\$(MAINBOARDDIR)/off_mode_charging.bmp"

if PLATFORM_HAS_SECONDARY_BOOT_INDICATOR_LOGO

config PLATFORM_OFF_MODE_CHARGING_INDICATOR_LOGO_SECONDARY_PATH
	string "Path to secondary off-mode charging logo"
	default "3rdparty/blobs/mainboard/\$(MAINBOARDDIR)/off_mode_charging_alt.bmp"

endif # PLATFORM_HAS_SECONDARY_BOOT_INDICATOR_LOGO
endif # PLATFORM_HAS_OFF_MODE_CHARGING_INDICATOR

config FRAMEBUFFER_SPLASH_TEXT
	bool "Enable splash screen text"
	default n
	help
	  Enable logic to render bitmapped text strings directly into
	  the linear framebuffer during the splash screen stage. This
	  method uses a bitmapped font table to display system
	  status messages, such as battery charging levels.

if FRAMEBUFFER_SPLASH_TEXT

choice
	prompt "Font Selection"
	default FONT_GOOGLE_SANS_FLEX_MEDIUM_24X32

config FONT_GOOGLE_SANS_FLEX_MEDIUM_24X32
	bool "Google Sans Flex Medium 24x32"
	help
	  Use the Google Sans Medium font table generated from
	  GoogleSansFlex_24pt-Medium.ttf using `generate_font.py` script.
	  Dimensions: 24x32 pixels.

endchoice

config FONT_WIDTH
	int
	default 24 if FONT_GOOGLE_SANS_FLEX_MEDIUM_24X32
	default 16
	help
	  The width of the font canvas in pixels.

config FONT_HEIGHT
	int
	default 32 if FONT_GOOGLE_SANS_FLEX_MEDIUM_24X32
	default 24
	help
	  The height of the font canvas in pixels.

endif # FRAMEBUFFER_SPLASH_TEXT

endmenu

config HAVE_EARLY_POWEROFF_SUPPORT
	bool
	help
	  Enable platform-specific early power off support.

	  This option should be selected if the platform requires special handling
	  to power off the system before memory initialization. This is often
	  necessary on Intel platforms, as directly powering off before memory
	  initialization is typically not supported by the chipset.

	  Selecting this option indicates that the platform implements the
	  `platform_do_early_poweroff()` function, which performs the
	  necessary hardware operations to initiate an early power off sequence.
	  This might involve configuring hardware registers, sending commands to
	  power management controllers, or other platform-specific operations.
```
