## .site-local/validation/20261003/native-lvgl-normal-after623/default-zero/kconfig/defconfig
```kconfig
CONFIG_CDK2_PAYLOAD=y
CONFIG_CDK2_PCI=y
CONFIG_CDK2_STORAGE=y
CONFIG_CDK2_CONSOLE=y
CONFIG_CDK2_GRAPHICS=y
# CONFIG_CDK2_SETUP_UI is not set
# CONFIG_CDK2_LVGL_RENDERER is not set
CONFIG_CDK2_ESRT=y
CONFIG_CDK2_NATIVE_DEVICE_PATH=y
CONFIG_CDK2_NATIVE_PARTITION=y
CONFIG_CDK2_NATIVE_FAT=y
CONFIG_CDK2_NATIVE_PCI_BUS=y
CONFIG_CDK2_NATIVE_SATA_CONTROLLER=y
CONFIG_CDK2_NATIVE_ATA_ATAPI_PASS_THRU=y
CONFIG_CDK2_NATIVE_ATA_BUS=y
CONFIG_CDK2_NATIVE_SCSI_BUS=y
CONFIG_CDK2_NATIVE_SCSI_DISK=y
CONFIG_CDK2_NATIVE_XHCI=y
CONFIG_CDK2_NATIVE_USB_BUS=y
CONFIG_CDK2_NATIVE_USB_MASS_STORAGE=y
# CONFIG_CDK2_NATIVE_USB_KEYBOARD is not set
# CONFIG_CDK2_NATIVE_USB_MOUSE is not set
# CONFIG_CDK2_NATIVE_SIO_BUS is not set
# CONFIG_CDK2_NATIVE_PS2_MOUSE is not set
# CONFIG_CDK2_NATIVE_TERMINAL is not set
CONFIG_CDK2_NATIVE_GRAPHICS_OUTPUT=y
CONFIG_CDK2_NATIVE_ACPI_TABLE=y
CONFIG_CDK2_NATIVE_SMMSTORE_FVB=y
CONFIG_CDK2_NATIVE_FTW=y
CONFIG_CDK2_NATIVE_CON_PLATFORM=y
CONFIG_CDK2_NATIVE_CON_SPLITTER=y
CONFIG_CDK2_NATIVE_EC_BATTERY=y
CONFIG_CDK2_NATIVE_RUNTIME_ARCH=y
# CONFIG_CDK2_NATIVE_UHCI is not set
# CONFIG_CDK2_NATIVE_EHCI is not set
CONFIG_CDK2_NATIVE_NVME=y
CONFIG_CDK2_NATIVE_SDMMC_PCI=y
CONFIG_CDK2_NATIVE_SD_DXE=y
CONFIG_CDK2_NATIVE_EMMC_DXE=y
CONFIG_CDK2_NATIVE_VARIABLE_RUNTIME=y
CONFIG_CDK2_NATIVE_CPU_ARCH=y
CONFIG_CDK2_CPU_VENDOR_INTEL=y
# CONFIG_CDK2_NATIVE_BDS is not set
# CONFIG_CDK2_NATIVE_SHELL is not set
CONFIG_CDK2_NATIVE_DXE_CORE=y
CONFIG_CDK2_NATIVE_STAGE=y
CONFIG_CDK2_LINEAR_BOOT=y
CONFIG_CDK2_NATIVE_SECURITY_STUB=n
CONFIG_CDK2_NULL_MEMORY_TEST=y
CONFIG_CDK2_NATIVE_WATCHDOG=y
CONFIG_CDK2_NATIVE_MONOTONIC_COUNTER=y
CONFIG_CDK2_NATIVE_STATUS_CODE_ROUTER=y
CONFIG_CDK2_NATIVE_CPU_IO2=y
CONFIG_CDK2_NATIVE_STATUS_CODE_HANDLER=y
CONFIG_CDK2_NATIVE_DISK_IO=y
CONFIG_CDK2_NATIVE_SERIAL_IO=y
CONFIG_CDK2_NATIVE_RESET_SYSTEM=y
CONFIG_CDK2_NATIVE_PCAT_RTC=y
CONFIG_CDK2_BUILD_DEBUG=n
CONFIG_CDK2_DEBUG=n
CONFIG_CDK2_SMMSTORE=y
CONFIG_CDK2_EC_ACPI_BATTERY_PROFILE=0
CONFIG_CDK2_CAPSULE=n
CONFIG_CDK2_CAPSULE_ACCEPT_EMBEDDED_DRIVERS=n
CONFIG_CDK2_CAPSULE_EMBED_FMP_DXE=n
CONFIG_CDK2_SECURE_BOOT=n
CONFIG_CDK2_SHELL=y
CONFIG_CDK2_NVME=y
CONFIG_CDK2_USB=y
CONFIG_CDK2_ATA=y
CONFIG_CDK2_SD=y
CONFIG_CDK2_PS2_MOUSE=y
CONFIG_CDK2_PS2_KEYBOARD=n
CONFIG_CDK2_SERIAL=n
CONFIG_CDK2_CBMEM_CONSOLE=n
CONFIG_CDK2_CBMEM_TIMESTAMPS=n
CONFIG_CDK2_BOOT_TIMEOUT=0
CONFIG_CDK2_TPM2=y
```
