## src/mainboard/emulation/qemu-q35/Kconfig
```kconfig
## SPDX-License-Identifier: GPL-2.0-only

if BOARD_EMULATION_QEMU_X86_Q35

config Q35_SMM_INVOCATION_NATIVE_COMPONENT
	bool "QEMU-only single-CPU native SMM loader component"
	default n
	depends on CPU_QEMU_X86_TSEG_SMM && HAVE_CF9_RESET
	depends on !HAVE_ACPI_RESUME
	select IOAPIC
	select Q35_SMM_INVOCATION_FAIL_STOP_TEST
	select SMM_INVOCATION_TOPOLOGY
	select SMM_INVOCATION_EVIDENCE
	select SMM_INVOCATION_LOADER_INSTANCE
	select SMM_INVOCATION_LOADER_INSTANCE_PLATFORM
	select SMM_INVOCATION_LOADER_COMPOSITION
	help
	  Supply a one-shot, genuinely random cold loader instance to the existing
	  protected SMM loader composition for a single-CPU native component.
	  Actual CPU count and RDRAND availability are checked before acquisition.
	  This supplies no DMA protection, invocation cause, command ownership,
	  service admission or authenticated-variable endpoint.

config Q35_SMM_INVOCATION_NATIVE_CAUSE_COMPONENT
	bool "QEMU-only immutable-flash native APMC component"
	default n
	depends on Q35_SMM_INVOCATION_NATIVE_COMPONENT && !SMMSTORE
	select SMM_INVOCATION_RUNTIME_VIEW
	select SMM_INVOCATION_RUNTIME_BINDING
	select SMMSTORE_READ_REGION
	help
	  Include an uncompressed native APMC leaf in boot media and reserve the
	  controlled single-CPU component for APMC-only SMIs. The component must
	  execute the actual flash leaf with its real bounded identity mapping.
	  This does not attest an arbitrary operating-system caller or install an
	  authenticated-variable endpoint. Legacy full-flash writers are excluded.

config SMM_MODULE_STACK_SIZE
	default 0x4000 if Q35_SMM_INVOCATION_NATIVE_CAUSE_COMPONENT

config Q35_SMM_INVOCATION_NATIVE_SERVICE_COMPONENT
	bool "QEMU-only native authenticated-variable service component"
	default n
	depends on Q35_SMM_INVOCATION_NATIVE_CAUSE_COMPONENT
	depends on !PAYLOAD_MM_AUTHVAR_REQUIRE_SELF_SIGNED_PK
	select Q35_PAYLOAD_MM_AUTHVAR_EXECUTOR_TEST_PROOF
	select PAYLOAD_MM_AUTHVAR_QEMU_PFLASH_BACKEND
	select PAYLOAD_MM_AUTHVAR_RECOVERY_PLANNER
	select PAYLOAD_MM_AUTHVAR_MOR_COMPLETION_SEAL
	select PAYLOAD_MM_AUTHVAR_SMM_BOOTSTRAP
	select BOOTMEM_ALIGNED_RESERVATIONS
	select BOOTMEM_ALIGNED_RESERVATION_RECEIPT
	select PAYLOAD_MM_AUTHVAR_PRESENCE_AUTHORITY
	select PAYLOAD_MM_AUTHVAR_PRESENCE_PRODUCER
	select PAYLOAD_MM_AUTHVAR_PRESENCE_PUBLICATION
	select PAYLOAD_MM_AUTHVAR_PRESENCE_TRANSACTION
	select PAYLOAD_MM_AUTHVAR_PRESENCE_TUPLE_SENDER
	select SMM_INVOCATION_TUPLE_TRIGGER
	select SMM_INVOCATION_ENTRY_PLATFORM
	select SMM_INVOCATION_ENTRY
	select SMM_PRE_LOCK_DISPATCH
	select SMM_APMC_COMMAND_REGISTRY
	select SMM_APMC_ROUTE_AUTHVAR_SERVICE
	select PAYLOAD_MM_AUTHVAR_SERVICE_ROUTE_ATTESTED
	select PAYLOAD_MM_AUTHVAR_SERVICE_BOOTSTRAP_ONLY
	help
	  Exercise the existing canonical service bootstrap and typed variable
	  backend through the actual immutable-flash APMC leaves. This controlled
	  single-CPU component requires QEMU secure pflash and checks ordinary
	  write denial in a separate scratch area before importing genuine loader
	  receipts. It grants no physical presence and is not an arbitrary-OS or
	  production platform service admission.

config SMMSTORE_SIZE
	default 0x10000 if Q35_SMM_INVOCATION_NATIVE_CAUSE_COMPONENT

config Q35_SMM_INVOCATION_NATIVE_PUBLIC_SERVICE_COMPONENT
	bool "QEMU-only public authenticated-variable APMC service component"
	default n
	depends on Q35_SMM_INVOCATION_NATIVE_SERVICE_COMPONENT
	select PAYLOAD_MM_AUTHVAR_STATE_PREDICATE_PINNED
	help
	  Keep the immutable cold bootstrap, but accept public variable requests
	  from the actual single CPU through the exclusively selected APMC service
	  command. The protected request snapshot proves public route ownership,
	  not a private caller instruction or physical-presence origin. This still
	  requires the controlled APMC-only, secure-pflash QEMU launch profile.
	  It provides no general multi-source or production-chipset attestation.

config SMMSTORE_BLOCK_SIZE
	default 4096 if Q35_SMM_INVOCATION_NATIVE_SERVICE_COMPONENT

config Q35_SMM_CAPSULE_BROKER_AUTH_POLICY
	bool "Install Q35 protected capsule authentication policy"
	default n
	depends on Q35_SMM_CAPSULE_BROKER_BUFFERS
	select PAYLOAD_MM_CMS_VERIFY
	select CAPSULE_BROKER_TRUST_PACKAGE
	help
	  Copy the configured public certificate and trusted compiled image facts
	  into the existing protected authentication owner during private cold
	  bootstrap. This installs no capsule endpoint, DMA verifier or writer.

config Q35_SMM_CAPSULE_BROKER_BUFFERS
	bool "Reserve Q35 protected capsule broker buffers"
	default n
	depends on Q35_SMM_CAPSULE_BROKER && Q35_VTD_DMA_TEST_BACKEND
	select CAPSULE_UPDATE_CONTRACT
	select CAPSULE_BROKER_CONTRACT
	select CAPSULE_BROKER_FIXED_BUFFERS
	select CAPSULE_BROKER_CBMEM_BUFFERS
	help
	  Reserve the existing early CBMEM communication and staging buffers and
	  import their actual geometry into the SMM loader. This provides allocation
	  ownership only; it installs no writer, endpoint or DMA protection proof.

config Q35_SMM_CAPSULE_BROKER
	bool "QEMU-only protected state owner for typed firmware capsules"
	default n
	depends on Q35_SMM_INVOCATION_NATIVE_PUBLIC_SERVICE_COMPONENT
	depends on !SMMSTORE
	depends on DRIVERS_EFI_FW_INFO
	select PAYLOAD_MM_CMS_CORE
	select PAYLOAD_MM_FMP_OWNER_AUTHVAR
	select PAYLOAD_MM_FMP_OWNER_AUTHVAR_BOOT
	help
	  Reconcile the existing protected FMP state through the real MM store
	  during the private cold bootstrap. Initial identity comes from the
	  trusted preinstalled coreboot image, not a payload firmware-info table.
	  This first owner prerequisite installs no capsule endpoint or writer
	  and promises no cryptographic live-ROM or hardware antirollback proof.

config SMM_TSEG_SIZE
	default 0x800000 if Q35_SMM_CAPSULE_BROKER_AUTH_POLICY
	default 0x200000 if Q35_SMM_INVOCATION_NATIVE_SERVICE_COMPONENT

config QEMU_PFLASH_VOLATILE_LEASE
	bool
	default n
	help
	  Provide a private owner-bound lease for QEMU pflash operations. Ordinary
	  region-device writes and erases are excluded for the complete lease. This
	  publishes no SMI endpoint and has no consumer unless separately selected.

config Q35_VTD_DMA_TEST_BACKEND
	bool "QEMU-only VT-d DMA handoff backend"
	depends on PAYLOAD_RESOURCE_HANDOFF
	select PAYLOAD_DMA_HANDOFF
	help
	  Establish default-deny VT-d domains with immutable, pre-mapped NVMe
	  and XHCI arenas before the payload. An unlisted EDU device supplies the
	  active denial oracle. This is a QEMU test backend, not production Intel
	  support.

config Q35_CAPSULE_UPDATE_TEST_PROOF
	bool "QEMU-only bounded capsule writer proof"
	default n
	select CAPSULE_UPDATE_CONTRACT
	help
	  Compile the dormant contract and verified region-writer prerequisite
	  for QEMU testing. This option publishes no handoff record and provides
	  no payload-callable broker: ordinary QEMU CBFS build_info is not an
	  authenticated live-ROM identity. The host proof uses an immutable test
	  route policy; it is not firmware authority.

config Q35_PAYLOAD_MM_AUTHVAR_TEST_PROOF
	bool "QEMU-only Payload-MM authenticated-variable boundary proof"
	default n
	depends on HAVE_SMI_HANDLER
	select PAYLOAD_MM_AUTHVAR_CONTRACT
	select PAYLOAD_MM_AUTHVAR_STORE_SCANNER
	select PAYLOAD_MM_AUTHVAR_STORE_SEMANTICS
	select PAYLOAD_MM_AUTHVAR_FTW_DECODER
	select PAYLOAD_MM_AUTHVAR_MEDIA_PORT
	select PAYLOAD_MM_AUTHVAR_WRITER
	help
	  Compile the dormant typed boundary, read-only store and FTW decoders,
	  read-only variable semantics and reclaim planner, the sealed SMMSTORE-
	  relative media-port prerequisite,
	  protected SystemFmp staging and fixed variable-owner port for hostile QEMU
	  testing. This does not install a producer, SMI command, MM dispatcher,
	  storage backend, plan executor, FTW executor or authenticated-variable
	  service. It grants no SPI access.

config Q35_PAYLOAD_MM_AUTHVAR_EXECUTOR_TEST_PROOF
	bool "QEMU-only Payload-MM authenticated-variable executor proof"
	default n
	depends on HAVE_SMI_HANDLER
	depends on !PAYLOAD_MM_AUTHVAR_REQUIRE_SELF_SIGNED_PK
	select Q35_PAYLOAD_MM_AUTHVAR_TEST_PROOF
	select PAYLOAD_MM_AUTHVAR_EXECUTOR
	select PAYLOAD_MM_AUTHVAR_FORMAT_PARSER
	select PAYLOAD_MM_AUTHVAR_SIGNATURE_DB
	select PAYLOAD_MM_AUTHVAR_CERTDB
	select PAYLOAD_MM_AUTHVAR_ROUTE
	select PAYLOAD_MM_AUTHVAR_CMS_VERIFY
	select PAYLOAD_MM_AUTHVAR_PRIVATE_BINDING
	select PAYLOAD_MM_AUTHVAR_PRIVATE_TRUST
	select PAYLOAD_MM_AUTHVAR_TRUST_ANCHOR
	select PAYLOAD_MM_AUTHVAR_TRUST_STORE
	select PAYLOAD_MM_AUTHVAR_AUTHORITY
	select PAYLOAD_MM_AUTHVAR_BUNDLE_PLAN
	select PAYLOAD_MM_AUTHVAR_CANDIDATE
	select PAYLOAD_MM_AUTHVAR_CANDIDATE_COMMIT
	select PAYLOAD_MM_AUTHVAR_COORDINATOR
	select PAYLOAD_MM_AUTHVAR_AUTHORITY_PROVIDER
	select PAYLOAD_MM_AUTHVAR_DEFAULT_STORE
	select PAYLOAD_MM_AUTHVAR_DEFAULT_STORE_RECOVERY
	select PAYLOAD_MM_AUTHVAR_VOLATILE_VIEW
	help
	  Compile the dormant linear SMM-only variable-plan/FTW executor, its sealed
	  arena, the pure Auth2/signature-list parser, authorization router,
	  protected-store PK/KEK trust policy, dormant Auth2 policy authority,
	  concrete authority trust dispatcher, fixed-role atomic bundle planner,
	  same-lease candidate commit, dormant linear authority-to-commit
	  coordinator, pure default-store composer,
	  same-lease pre-lifecycle erased-media recovery, immutable synthetic
	  volatile-variable view and pure private-variable certdb codec,
	  untrusted detached-CMS verifier, pure private-signer binding matcher and
	  one-anchor X.509 matcher for QEMU build proof. This installs no arena,
	  media backend, authority, endpoint, SMI
	  route or MM dispatcher and publishes no service. It grants no SPI access
	  and makes no production authenticated-variable claim.

config Q35_PAYLOAD_MM_MOR_TEST_ADAPTER
	bool "QEMU-only MOR platform-adapter prerequisites"
	default n
	depends on !SMMSTORE
	select Q35_PAYLOAD_MM_AUTHVAR_TEST_PROOF
	select PAYLOAD_MM_AUTHVAR_QEMU_PFLASH_BACKEND
	help
	  Compile the Q35 pflash media backend while excluding the legacy raw
	  SMMSTORE mutation endpoint. This is only the configuration boundary for
	  the future Q35 adapter: it invokes no SMM bootstrap or backend
	  installer and adds no private channel, orchestrator or support claim.

config Q35_PAYLOAD_MM_MOR_LINEAR_TEST_PROVIDER
	bool
	default n
	depends on HAVE_SMI_HANDLER
	depends on CPU_QEMU_X86_TSEG_SMM
	depends on SMM_MODULE_STACK_SIZE >= 0x4000
	depends on !HAVE_ACPI_RESUME && !SMMSTORE
	depends on Q35_PAYLOAD_MM_AUTHVAR_EXECUTOR_TEST_PROOF
	depends on Q35_PAYLOAD_MM_MOR_TEST_ADAPTER
	depends on PAYLOAD_RESOURCE_HANDOFF && Q35_VTD_DMA_TEST_BACKEND
	depends on BOOTMEM_ALIGNED_RESERVATIONS
	depends on BOOTMEM_ALIGNED_RESERVATION_RECEIPT
	depends on PAYLOAD_MM_AUTHVAR_MOR_POLICY
	depends on PAYLOAD_MM_AUTHVAR_MOR_ENTRY_PROBE
	depends on PAYLOAD_MM_AUTHVAR_MOR_COMPLETION_SEAL
	depends on PAYLOAD_MM_AUTHVAR_RECOVERY_PLANNER
	depends on PAYLOAD_MM_AUTHVAR_MOR_CONTROL_CLEAR_TRANSACTION
	depends on PAYLOAD_MM_AUTHVAR_SMM_BOOTSTRAP
	depends on PAYLOAD_MM_AUTHVAR_MOR_PRIVATE_SMI
	depends on PAYLOAD_MM_AUTHVAR_MOR_LIVE_INVENTORY
	depends on PAYLOAD_MM_AUTHVAR_MOR_CLEAR_RECEIPT
	depends on PAYLOAD_MM_AUTHVAR_MOR_CLEAR_EXECUTOR
	depends on PAYLOAD_MM_AUTHVAR_MOR_CLEAR_X86_BACKEND
	depends on PAYLOAD_MM_AUTHVAR_MOR_LINEAR_ORCHESTRATOR
	depends on PAYLOAD_MM_AUTHVAR_MOR_EARLY_DISCOVERY
	help
	  Build the hidden QEMU-only cold-boot MOR composition from the private
	  first-use SMI channel, private pflash media and VT-d test backend. No
	  board selects it, and it publishes no operating-system endpoint.

config SMMSTORE_BLOCK_SIZE
	default 4096 if Q35_PAYLOAD_MM_MOR_LINEAR_TEST_PROVIDER

config SMMSTORE_SIZE
	default 0x10000 if Q35_PAYLOAD_MM_MOR_LINEAR_TEST_PROVIDER

config Q35_CAPSULE_BROKER_TEST_PROOF
	bool "QEMU-only dormant capsule broker proof"
	default n
	depends on HAVE_SMI_HANDLER
	select CAPSULE_UPDATE_CONTRACT
	select PAYLOAD_MM_AUTHVAR_CONTRACT
	select CAPSULE_BROKER_CONTRACT
	select PAYLOAD_MM_CMS_VERIFY
	help
	  Compile the unselected one-shot broker state machine in SMM. This option
	  publishes no endpoint, registers no SMI command and supplies no flash or
	  durable-variable backend. Its fixed-arena CMS verifier has no trust-policy
	  provider. The checkpoint bridge is test-only until a backend provides
	  atomic, reset-safe, rollback-protected persistence.

config Q35_CAPSULE_FIXED_BUFFER_TEST_PROOF
	bool "QEMU-only fixed capsule buffer reservation proof"
	default n
	select Q35_CAPSULE_BROKER_TEST_PROOF
	select CAPSULE_BROKER_FIXED_BUFFERS
	help
	  Reserve fixed communication and bounded staging memory from the QEMU
	  resource map and compile protected SMM scratch. This proves allocation
	  and lifetime only. It does not claim DMA protection, install the broker,
	  register an SMI route or publish an endpoint.

config Q35_CAPSULE_DMA_TEST_PROOF
	bool "QEMU-only exact capsule DMA protection proof"
	default n
	select PAYLOAD_RESOURCE_HANDOFF
	select Q35_VTD_DMA_TEST_BACKEND
	select Q35_CAPSULE_FIXED_BUFFER_TEST_PROOF
	help
	  Exercise real denied EDU DMA writes against the complete fixed
	  communication and staging reservations. NVMe and XHCI retain their
	  separately mapped positive-control arenas. This supplies a test-only
	  range-proof callback, but does not install the broker, register an SMI
	  route or publish an endpoint.

config Q35_TPM2_FIFO_PRE_OS_LIFECYCLE
	bool "QEMU-only late TPM2 FIFO lifecycle owner"
	depends on TPM2 && MEMORY_MAPPED_TPM
	depends on !CRB_TPM && !AMD_CRB_FTPM && !I2C_TPM && !SPI_TPM
	select TPM2_FIFO_PRE_OS_LIFECYCLE
	help
	  Transfer QEMU's initialized TPM 2.0 FIFO route to the exclusive pre-OS
	  lifecycle after payload loading and relinquish locality 0 immediately
	  before payload execution. This selects no capsule or policy provider.

config Q35_TPM2_PLATFORM_AUTH_CODECS_TEST
	bool "QEMU-only TPM2 platform authorization codecs"
	default n
	depends on TPM2 && MEMORY_MAPPED_TPM
	depends on !CRB_TPM && !AMD_CRB_FTPM && !I2C_TPM && !SPI_TPM
	select Q35_TPM2_FIFO_PRE_OS_LIFECYCLE
	select TPM2_PLATFORM_AUTH_CODECS
	help
	  Compile the dormant strict platform-authorized command codecs into the
	  QEMU FIFO lifecycle ramstage archive. There is no runtime reference, so
	  the final image may dead-strip them. This does not execute a command,
	  select a policy provider or publish a production platform route.

config Q35_SMM_INVOCATION_FAIL_STOP_TEST
	bool
	default n
	depends on HAVE_SMI_HANDLER && HAVE_CF9_RESET
	select SMM_INVOCATION_FAIL_STOP_PLATFORM
	help
	  Supply the QEMU q35-only terminal SMM fail-stop provider. The provider
	  requests a full CF9 reset, falls back to a system CF9 reset, and halts
	  only if QEMU accepts neither request. This selects no invocation route.

config Q35_PAYLOAD_MM_OWNER_FMAP_TEST_PROOF
	bool "QEMU-only Payload-MM owner FMAP proof"
	default n
	depends on !VBOOT
	select Q35_CAPSULE_BROKER_TEST_PROOF
	help
	  Build a QEMU-only 8 MiB image with two distinct 64 KiB preserved
	  FMP_STATE journal domains and a preserved SMMSTORE range. Each journal
	  domain contains sixteen 4 KiB slots. This proves only the immutable FMAP
	  geometry; it installs no journal backend, broker, SMI route or endpoint.

config BOARD_SPECIFIC_OPTIONS
	def_bool y
	select SMM_APMC_COMPOSITION_ATTESTED
	select SMM_APMC_ROUTE_ACPI_CONTROL
	select SMM_APMC_ROUTE_ELOG
	select SMM_APMC_ROUTE_FINALIZE
	select SMM_APMC_ROUTE_SMMSTORE
	select SMM_APMC_ROUTE_SPI_CONSOLE
	select CPU_QEMU_X86
	select SOUTHBRIDGE_INTEL_I82801IX
	select HAVE_CMOS_DEFAULT
	select HAVE_OPTION_TABLE
#	select HAVE_PIRQ_TABLE
	select HAVE_ACPI_TABLES
	select BOARD_ROMSIZE_KB_8192
	select MAINBOARD_HAS_NATIVE_VGA_INIT
	select MAINBOARD_FORCE_NATIVE_VGA_INIT if !CHROMEOS
	select MEMORY_MAPPED_TPM
	select MAINBOARD_HAS_CHROMEOS
	select BOOT_DEVICE_NOT_SPI_FLASH
	select BOOT_DEVICE_MEMORY_MAPPED
	select BOOT_DEVICE_SUPPORTS_WRITES
	select DRIVERS_EMULATION_QEMU_FW_CFG

config VBOOT
	select VBOOT_MUST_REQUEST_DISPLAY
	select VBOOT_STARTS_IN_BOOTBLOCK
	select VBOOT_VBNV_CMOS
	select GBB_FLAG_DISABLE_LID_SHUTDOWN
	select GBB_FLAG_DISABLE_PD_SOFTWARE_SYNC
	select GBB_FLAG_DISABLE_EC_SOFTWARE_SYNC
	select GBB_FLAG_DISABLE_FWMP

config FMDFILE
	default "src/mainboard/\$(CONFIG_MAINBOARD_DIR)/native-service-8M.fmd" if Q35_SMM_INVOCATION_NATIVE_SERVICE_COMPONENT
	default "src/mainboard/\$(CONFIG_MAINBOARD_DIR)/payload-mm-owner-8M.fmd" if Q35_PAYLOAD_MM_OWNER_FMAP_TEST_PROOF
	default "src/mainboard/\$(CONFIG_MAINBOARD_DIR)/vboot-rwa-8M.fmd" if VBOOT_SLOTS_RW_A && !VBOOT_SLOTS_RW_AB
	default "src/mainboard/\$(CONFIG_MAINBOARD_DIR)/vboot-rwab-8M.fmd" if VBOOT_SLOTS_RW_AB

if ARCH_BOOTBLOCK_X86_64

config PAGE_TABLES_IN_CBFS
	bool
	default y

# Need to install page tables in DRAM as the virtual MMU has problems translating paging
# request when the page table resides in emulated ROM. This causes undefined behaviour
# when handling data requests, as well as fetching and decoding instructions
# Real hardware didn't show any problems until now.
config ARCH_X86_64_PGTBL_LOC
	default 0x8000
endif

if VBOOT

config VBOOT_SLOTS_RW_A
	default y

endif

config VBOOT_VBNV_OFFSET
	hex
	default 0x2c

config MAINBOARD_DIR
	default "emulation/qemu-q35"

config MAINBOARD_PART_NUMBER
	default "QEMU x86 q35/ich9"

config ECAM_MMCONF_BASE_ADDRESS
	default 0xb0000000

config ECAM_MMCONF_BUS_NUMBER
	int
	default 256

# fw_cfg tables can be larger than the default when TPM is enabled
config MAX_ACPI_TABLE_SIZE_KB
	int
	default 224

# Skip the first 64KiB as coreboot table pointer is installed
# at address 0
config DCACHE_RAM_BASE
	hex
	default 0x10000

# Memory at 0xa0000 decodes to VGA
config DCACHE_RAM_SIZE
	hex
	default 0x90000

# Do not show IFD/blob options since QEMU doesn't care
config HAVE_INTEL_FIRMWARE
	bool
	default n

config PAYLOAD_LOCAL_APIC_TIMER_INFO
	bool "Publish measured local APIC timer frequency to the payload"
	default n
	help
	  Measure the QEMU local APIC timer against the ICH9 ACPI PM timer and
	  publish the result in the coreboot table for payloads that require an
	  authoritative timer input frequency.

config DCACHE_BSP_STACK_SIZE
	hex
	default 0x4000

endif # BOARD_EMULATION_QEMU_X86_Q35
```
