## .site-local/validation/20261005/closed-build-contexts/owned-lvgl-config-after524/build/debug-macro-context/kconfig/defconfig
```kconfig
CONFIG_CDK2_COREBOOT_CAPSULE_PROFILE=y
CONFIG_CDK2_CPU_VENDOR_INTEL=y
CONFIG_CDK2_QEMU_ACCEPTANCE_PROFILE=y
CONFIG_CDK2_LINEAR_BOOT=y
CONFIG_PAYLOAD_DMA_HANDOFF=y
CONFIG_CDK2_DEBUG=y
CONFIG_CDK2_DIAGNOSTIC=y
CONFIG_CDK2_SERIAL=y
CONFIG_CDK2_CBMEM_CONSOLE=y
CONFIG_CDK2_SPI_CONSOLE=y
CONFIG_CDK2_SETUP_UI=y
CONFIG_CDK2_LVGL_RENDERER=y
CONFIG_CDK2_NATIVE_LVGL_SETUP=y
CONFIG_CDK2_NATIVE_BDS=y
CONFIG_CDK2_NATIVE_SHELL=n
CONFIG_CDK2_NATIVE_CON_PLATFORM=n
CONFIG_CDK2_NATIVE_USB_KEYBOARD=y
CONFIG_CDK2_NULL_MEMORY_TEST=n
CONFIG_CDK2_TPM_CONFIG=n
CONFIG_CDK2_LINEAR_BDS_FAILOVER=y
CONFIG_CDK2_LINEAR_SETUP_HOTKEY=y
CONFIG_CDK2_BOOT_TIMEOUT=3
```

## .site-local/validation/20261005/presence-build-contexts/authvar-presence-bootstrap/build/cdk2/native/ec-battery-sbs-config/kconfig/defconfig
```kconfig
CONFIG_CDK2_PAYLOAD=y
CONFIG_CDK2_NATIVE_STAGE=y
CONFIG_CDK2_NATIVE_EC_BATTERY=y
CONFIG_CDK2_EC_ACPI_BATTERY_PROFILE=5
CONFIG_CDK2_EC_BATTERY_DATA_PORT=0x72
CONFIG_CDK2_EC_BATTERY_COMMAND_PORT=0x76
CONFIG_CDK2_EC_BATTERY_SBS_WORD_READ_COMMAND=0x90
CONFIG_CDK2_EC_BATTERY_SBS_PRESENT_MASK=0
```

## payloads/external/cdk2/Kconfig.name
```kconfig
## SPDX-License-Identifier: GPL-2.0-only

config PAYLOAD_CDK2
	bool "CDK2"
	depends on ARCH_X86
	select WANT_LINEAR_FRAMEBUFFER
	select PAYLOAD_OWNS_PCI_DEVICES
	help
	  Build CDK2 from the pinned source submodule and add its native ELF as
	  the primary payload. CDK2 consumes coreboot tables through the standard
	  protected-mode payload entry ABI.
```

## src/drivers/efi/Kconfig
```kconfig
## SPDX-License-Identifier: GPL-2.0-only

config DRIVERS_EFI_VARIABLE_STORE
	bool "Include EFI variable store driver"
	select UDK_2017_BINDING if !PLATFORM_USES_FSP2_0 && !PLATFORM_USES_FSP1_1
	help
	  Adds a driver that is able to read and write an EFI formatted
	  VariableStore as used by tianocore.

config DRIVERS_EFI_FW_INFO
	bool "Expose firmware version in a EFI-friendly form"
	select UDK_2017_BINDING if !PLATFORM_USES_FSP2_0 && !PLATFORM_USES_FSP1_1
	help
	  Adds firmware version information to coreboot table in a form similar to
	  EFI System Resource Table (ESRT) that can be used for firmware updates.

config DRIVERS_EFI_MAIN_FW_GUID
	string "GUID of the firmware"
	default "00112233-4455-6677-8899-aabbccddeeff"
	depends on DRIVERS_EFI_FW_INFO
	help
	  GUID used to identify firmware kind for the purposes of updates.

config DRIVERS_EFI_MAIN_FW_VERSION
	hex "Version of the firmware"
	range 0x00000000 0xFFFFFFFF
	default 0x00000000
	depends on DRIVERS_EFI_FW_INFO
	help
	  32-bit unsigned integer representing current firmware's version.

	  If set to 0, coreboot will try to derive a version from LOCALVERSION by
	  parsing a leading "<major>.<minor>" and encoding it as
	  (major << 16) | minor.

	  Non-digits before and after "<major>.<minor>" are ignored.
	  Examples:
	  - "26.01" -> 0x001A0001
	  - "v26.01-rc1" -> 0x001A0001

config DRIVERS_EFI_MAIN_FW_LSV
	hex "Lowest supported firmware version"
	range 0x00000000 0xFFFFFFFF
	default 0x00000000
	depends on DRIVERS_EFI_FW_INFO
	help
	  32-bit unsigned integer representing lowest firmware version number
	  that is allowed to replace the current one.  Can be used to forbid
	  bugged versions.

	  If set to 0, coreboot uses DRIVERS_EFI_MAIN_FW_VERSION.

config DRIVERS_EFI_CAPSULE_RAM_HANDOFF
	bool "Discover reset-persistent EFI capsules in DRAM"
	depends on DRIVERS_EFI_VARIABLE_STORE
	select SMMSTORE_READ_REGION
	help
	  Adds a driver that is able to parse CapsuleUpdateData* EFI variables
	  to discover firmware updates and expose them to the payload through the
	  coreboot table. The payload is responsible for erasing the variables.

	  This only reads the EFI variable store and preserves the referenced DRAM.
	  It does not grant the payload writable access to the variable store or
	  flash device.

config DRIVERS_EFI_CAPSULE_DELIVERY_POLICY
	bool "Publish EFI capsule delivery policy"
	default n
	help
	  Describe the platform's allowed RAM and disk delivery paths and capsule
	  size limits for a generic payload. RAM requires a platform implementation
	  that establishes warm-reset DRAM persistence as well as the RAM handoff
	  driver. Unknown persistence is not advertised. Disk reuses the existing
	  capsule-on-disk policy without changing its dependencies.

	  This does not discover capsules, select an updater, or grant flash access.

config DRIVERS_EFI_CAPSULE_MAX_NONPOPULATE_SIZE
	hex "Maximum non-populate capsule size"
	default 0x4000000
	range 0x1 0xffffffff
	depends on DRIVERS_EFI_CAPSULE_DELIVERY_POLICY

config DRIVERS_EFI_CAPSULE_MAX_POPULATE_SIZE
	hex "Maximum populate capsule size"
	default 0x4000000
	range 0x0 0xffffffff
	depends on DRIVERS_EFI_CAPSULE_DELIVERY_POLICY
	help
	  Zero disables populate capsules. This policy limit does not override a
	  separately published capsule broker's staging or writable-region bounds.

config DRIVERS_EFI_UPDATE_CAPSULES
	bool "Include legacy EFI update capsules driver"
	depends on DRIVERS_EFI_VARIABLE_STORE && SMMSTORE && DRIVERS_EFI_FW_INFO
	depends on !CAPSULE_BROKER_CONTRACT
	select DRIVERS_EFI_CAPSULE_RAM_HANDOFF
	help
	  Enable the legacy EFI capsule update path. In addition to discovering
	  reset-persistent capsules in DRAM, this grants the payload generic
	  full-flash access through SMMSTORE while an update is pending.

	  New platforms should use DRIVERS_EFI_CAPSULE_RAM_HANDOFF with a bounded
	  update mechanism instead.

config DRIVERS_EFI_CAPSULE_ON_DISK_SUPPORT
	bool "Support EFI capsules on disk"
	depends on DRIVERS_EFI_UPDATE_CAPSULES
	default y if SOC_AMD_COMMON
	help
	  Permit update capsules to be submitted via the EFI system
	  partition instead of relying on capsule pointers surviving reset.
	  Scanning DRAM for capsules is not reliable on some platforms, so this option is
	  required for those platforms.

config DRIVERS_EFI_CAPSULE_ACCEPT_EMBEDDED_DRIVERS
	bool "Allow embedded drivers in update capsules"
	depends on PAYLOAD_EDK2 && DRIVERS_EFI_UPDATE_CAPSULES
	help
	  Allow the EDK2 payload's capsule processing to load embedded drivers
	  from capsules (PcdCapsuleEmbeddedDriverSupport).

	  This is required for capsules that contain embedded drivers.

	  Note: if Secure Boot is enabled, the embedded driver must be signed by a
	  key trusted by the running firmware (or capsule processing may fail).

config DRIVERS_EFI_CAPSULE_LEGACY_TRANSPORT
	bool
	default y if PAYLOAD_EDK2 && DRIVERS_EFI_UPDATE_CAPSULES
	help
	  Identify the legacy payload-owned capsule transport. Its update image may
	  carry an RMAP trailer consumed by the EDK2 updater.

config DRIVERS_EFI_CAPSULE_TYPED_TRANSPORT
	bool
	depends on !DRIVERS_EFI_UPDATE_CAPSULES
	depends on CAPSULE_BROKER_ENDPOINT_PUBLICATION
	depends on CAPSULE_PLATFORM_ADAPTERS
	depends on PAYLOAD_MM_CMS_VERIFY
	depends on PAYLOAD_MM_FMP_OWNER_AUTHVAR_BOOT
	help
	  Identify a selected, production coreboot-owned typed capsule transport.
	  A platform composition must add a conditional default for this only after
	  it has installed the complete broker policy, protected FMP owner and
	  authenticated endpoint. Merely building the dormant broker objects must
	  not enable this symbol.

config DRIVERS_EFI_GENERATE_CAPSULE
	bool "Generate an update capsule during the build"
	depends on DRIVERS_EFI_CAPSULE_LEGACY_TRANSPORT || DRIVERS_EFI_CAPSULE_TYPED_TRANSPORT
	depends on DRIVERS_EFI_FW_INFO
	help
	  Generate a signed UEFI FMP capsule from the final ROM image using
	  coreboot-owned tooling. The selected runtime transport determines whether
	  the update image carries the legacy EDK2 RMAP trailer or the exact ROM
	  required by coreboot's typed broker.

config DRIVERS_EFI_CAPSULE_EMBED_FMP_DXE
	bool "Embed FmpDxe driver into generated capsules"
	depends on DRIVERS_EFI_GENERATE_CAPSULE
	depends on DRIVERS_EFI_CAPSULE_ACCEPT_EMBEDDED_DRIVERS
	help
	  When generating build/coreboot.cap, embed the built FmpDxe.efi as an
	  embedded driver in the capsule, rather than in the ROM image itself.

	  Note: if Secure Boot is enabled, FmpDxe.efi must be signed by a key
	  trusted by the running firmware (or capsule processing may fail).


config DRIVERS_EFI_CAPSULE_INITIATE_RESET
	bool "Request reset after capsule is applied"
	default n
	depends on DRIVERS_EFI_GENERATE_CAPSULE
	depends on DRIVERS_EFI_CAPSULE_LEGACY_TRANSPORT
	help
	  Add the InitiateReset capsule flag when generating build/coreboot.cap.

	  Note: Linux rejects capsules with InitiateReset when using
	  /dev/efi_capsule_loader. CDK2's typed capsule contract accepts only the
	  persist-across-reset flag and owns reset after a successful transaction.


config DRIVERS_EFI_CAPSULE_REGIONS
	string "FMAP regions to include in the capsule manifest"
	default "COREBOOT"
	depends on DRIVERS_EFI_GENERATE_CAPSULE
	depends on DRIVERS_EFI_CAPSULE_LEGACY_TRANSPORT
	help
	  Whitespace-separated list of FMAP regions that the update capsule is
	  allowed to modify. Legacy EDK2 capsules embed this list as an RMAP
	  manifest. The typed broker instead derives its exact writable routes from
	  coreboot's protected runtime policy and does not use this setting.

menu "Capsule signing certificates"
	depends on DRIVERS_EFI_UPDATE_CAPSULES || DRIVERS_EFI_GENERATE_CAPSULE

config DRIVERS_EFI_CAPSULE_SIGNER_PRIVATE_CERT
	string "PEM file used to sign generated capsules"
	default "BaseTools/Source/Python/Pkcs7Sign/TestCert.pem" if \
		DRIVERS_EFI_CAPSULE_LEGACY_TRANSPORT
	depends on DRIVERS_EFI_GENERATE_CAPSULE
	help
	  Path to a PEM file containing the private key and leaf certificate used
	  when signing the capsule with coreboot's capsule generator.

	  For EDK2's compatibility defaults, relative paths are interpreted from
	  its checked-out workspace. CDK2 profiles must use a coreboot-relative or
	  absolute path explicitly.

config DRIVERS_EFI_CAPSULE_OTHER_PUBLIC_CERT
	string "Intermediate certificate for capsule signing (PEM)"
	default "BaseTools/Source/Python/Pkcs7Sign/TestSub.pub.pem" if \
		DRIVERS_EFI_CAPSULE_LEGACY_TRANSPORT
	depends on DRIVERS_EFI_GENERATE_CAPSULE
	help
	  Path to the intermediate certificate (PEM) used when generating a PKCS#7
	  signature for the capsule.

	  For EDK2's compatibility default, a relative path is interpreted from its
	  checked-out workspace. CDK2 profiles must configure the path explicitly.

config DRIVERS_EFI_CAPSULE_TRUSTED_PUBLIC_CERT
	string "Trusted root certificate for capsule signing (PEM)"
	default "BaseTools/Source/Python/Pkcs7Sign/TestRoot.pub.pem" if \
		DRIVERS_EFI_CAPSULE_LEGACY_TRANSPORT
	depends on DRIVERS_EFI_UPDATE_CAPSULES || DRIVERS_EFI_GENERATE_CAPSULE
	help
	  Path to the trusted root certificate (PEM) used when generating a PKCS#7
	  signature for the capsule.

	  For EDK2's compatibility default, a relative path is interpreted from its
	  checked-out workspace. CDK2 profiles must configure the path explicitly.

endmenu
```

## src/drivers/efi_variable_service/Kconfig
```kconfig
## SPDX-License-Identifier: GPL-2.0-only

config ASS
	bool "Authorised SMM Service (ASS)"
	depends on HAVE_SMI_HANDLER
	depends on SMM_TSEG
	depends on SMMSTORE
	depends on ARCH_SMM_X86_32
	depends on PAYLOAD_EDK2 || PAYLOAD_CDK2
	depends on SOC_INTEL_COMMON_BLOCK_SMM
	depends on SOC_INTEL_COMMON_BLOCK_FAST_SPI
	depends on !CONSOLE_SPI_FLASH
	select SPI_FLASH_SMM if BOOT_DEVICE_SPI_FLASH_RW_NOMMAP
	help
	  ASS stands for Authorised SMM Service. Run the build-selected EFI
	  variable and capsule service in a fixed SMRAM region. The payload can
	  submit requests through a bounded shared buffer, but cannot supply
	  executable code or choose the service address.
	  The selected EDK2 source must provide the fixed Standalone MM service.
	  Building that service does not require using EDK2 as the payload.

# Keep the decompressed FV out of the S3-cached ramstage image.
config HEAP_SIZE
	default SMM_ASS_SIZE if ASS
```

## src/drivers/option/Kconfig
```kconfig
config DRIVERS_OPTION_CFR_ENABLED
	def_bool n

config DRIVERS_OPTION_CFR
	bool "Support generating a CFR list of options"
	select DRIVERS_EFI_VARIABLE_STORE if PAYLOAD_MM_INTERFACE || (PAYLOAD_EDK2 && SMMSTORE)
	default y if DRIVERS_OPTION_CFR_ENABLED

config HAVE_CFR_RUNTIME_APPLY_SUPPORT
	bool

config DRIVERS_OPTION_CFR_RUNTIME_APPLY
	bool
	depends on ARCH_X86
	depends on DRIVERS_OPTION_CFR
	depends on HAVE_SMI_HANDLER
	depends on HAVE_CFR_RUNTIME_APPLY_SUPPORT
```

## src/drivers/payload_mm_interface/Kconfig
```kconfig
## SPDX-License-Identifier: GPL-2.0-only

config HAVE_PAYLOAD_MM_INTERFACE
	def_bool n
	help
	  Selected by platforms that have implemented support for payload MM.

config PAYLOAD_MM_INTERFACE
	bool "Support coreboot-mediated payload MM"
	depends on HAVE_SMI_HANDLER
	depends on HAVE_PAYLOAD_MM_INTERFACE
	# Needed by `smmstore_lookup_region` helper function to EFIVARS option system.
	select SPI_FLASH_SMM if BOOT_DEVICE_SPI_FLASH_RW_NOMMAP
	default n
	help
	  Implements coreboot-to-payload compatibility layers for sharing SMM. coreboot will
	  continue to initialise and own SMM. Payload can register to be called on SMI too.
	  An example use-case is enabling EDK2 Secure Boot with Authenticated Variables.

	  Select N if unsure.

config PAYLOAD_MM_SMRAM_SIZE
	hex
	depends on PAYLOAD_MM_INTERFACE
	default 0x155000
	help
	  The amount of SMRAM to reserve for payload MM. This amount is sufficient for Secure Boot,
	  with some left over as spare. It requires platforms to support 2M of SMRAM.

# Initialise size of reused "SMMSTORE" FMAP region for native SPI services
config SMMSTORE_SIZE
	depends on !SMMSTORE && PAYLOAD_MM_INTERFACE
	default 0x40000
```
